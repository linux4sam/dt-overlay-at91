// SPDX-License-Identifier: (GPL-2.0+ OR MIT)
/*
 * sama5d27_wlsom1_ek_ptc.dtso - Device Tree file for SAMA5D27 WLSOM1 EK board
 * overlay blob for PTC.
 *
 * Copyright (C) 2019 Microchip Technology, Inc.
 * Author: Codrin Ciubotariu <codrin.ciubotariu@microchip.com>
 *
 */
/dts-v1/;
/plugin/;

&{/ahb/apb/ptc@fc060000} {
	status = "okay";
};
