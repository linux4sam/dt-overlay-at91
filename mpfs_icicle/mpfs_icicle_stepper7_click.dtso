// SPDX-License-Identifier: (GPL-2.0+ OR MIT)
/*
 * Device Tree Overlay for Mikroe Stepper 7 Click
 *
 * Copyright (C) 2024 Microchip Technology Inc. and its subsidiaries.
 * Author: Ahmed Mujtaba Ali <ahmed.ali2@microchip.com>
 *
 */

/dts-v1/;
/plugin/;

/ {
        compatible = "microchip,mpfs-icicle-reference-rtlv2210", "microchip,mpfs-icicle-kit","microchip,mpfs";
};

&spi1 {
        pinctrl@0 {
                compatible = "microchip,mcp23s08";
                reg = <0>;
                spi-max-frequency = <100000>;
                spi-rx-bus-width = <1>;
                spi-cpha;
                spi-cpol;
                microchip,spi-present-mask = <0x01>;
        };
};

