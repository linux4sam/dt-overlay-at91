// SPDX-License-Identifier: (GPL-2.0+ OR MIT)
/*
 * Device Tree Overlay for Pmod SF3 + Pmod HAT adapter
 *
 * Copyright (C) 2022 Microchip Technology Inc. and its subsidiaries.
 * Author: Valentina Fernandez <valentina.fernandezalanis@microchip.com>
 *
 */

/dts-v1/;
/plugin/;

/ {
	compatible = "microchip,mpfs-icicle-reference-rtlv2209", "microchip,mpfs-icicle-kit","microchip,mpfs";
};

&qspi {
	flash@0 {
		compatible = "jedec,spi-nor";
		reg = <0>;
		spi-max-frequency = <12500000>;
		status = "okay";
	};
};
