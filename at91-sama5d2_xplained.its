## at91-sama5d2_xplained.its
```
/*
 * Simple U-boot uImage source file containing a single kernel and FDT blob
 */

/dts-v1/;

/ {
	description = "Atmel SAMA5D2 Xplained FIT Image";
	#address-cells = <1>;

	images {
		base_fdt {
			description = "Flattened Device Tree blob";
			data = /incbin/("./at91-sama5d2_xplained.dtb");
			type = "flat_dt";
			arch = "arm";
			compression = "none";
			load = <0x23000000>;
			hash@1 {
				algo = "crc32";
			};
			hash@2 {
				algo = "sha1";
			};
		};

		fdt_isc {
			description = "Device Tree blob ISC overlay";
			data = /incbin/("./at91-sama5d2_xplained/at91-sama5d2_xplained_isc.dtbo");
			type = "flat_dt";
			arch = "arm";
			compression = "none";
			load = <0x23100000>;
			hash@1 {
				algo = "crc32";
			};
			hash@2 {
				algo = "sha1";
			};
		};

		fdt_ov7670 {
			description = "Device Tree blob Ov7670 overlay";
			data = /incbin/("./at91-sama5d2_xplained/at91-sama5d2_xplained_ov7670.dtbo");
			type = "flat_dt";
			arch = "arm";
			compression = "none";
			load = <0x23110000>;
			hash@1 {
				algo = "crc32";
			};
			hash@2 {
				algo = "sha1";
			};
		};

		fdt_pda4 {
			description = "Device Tree blob pda4300 overlay";
			data = /incbin/("./at91-sama5d2_xplained/at91-sama5d2_xplained_pda4.dtbo");
			type = "flat_dt";
			arch = "arm";
			compression = "none";
			load = <0x23120000>;
			hash@1 {
				algo = "crc32";
			};
			hash@2 {
				algo = "sha1";
			};
		};
	};

	configurations {
		default = "base_dtb";

		base_dtb {
			description = "FDT blob for base SAMA5D2_XPLAINED board";
			fdt = "base_fdt";
		};

		isc {
			description = "FDT overlay for isc";
			fdt = "fdt_isc";
		};

		ov7670 {
			description = "FDT overlay for ov7670 sensor";
			fdt = "fdt_ov7670";
		};

		pda4 {
			description = "FDT overlay for PDA TM4300 screen";
			fdt = "fdt_pda4";
		};
	};
};
```

## at91sam9x5ek.its
```
// SPDX-License-Identifier: (GPL-2.0+ OR MIT)
/*
 * Flattened Image Tree file for AT91SAM9X5-EK board
 *
 * Copyright (C) 2018 Microchip Technology, Inc.
 * Author: Cristian Birsan <cristian.birsan@microchip.com>
 *
 */
/dts-v1/;

/ {
	description = "Microchip SAM9x5-EK FIT Image";
	#address-cells = <1>;

	images {
		kernel {
			description = "Linux4SAM Linux kernel";
			data = /incbin/("./zImage");
			type = "kernel";
			arch = "arm";
			os = "linux";
			compression = "none";
			load = <0x22000000>;
			entry = <0x22000000>;
			hash-1 {
				algo = "crc32";
			};
			hash-2 {
				algo = "sha1";
			};
		};

		sam9g15ek_fdt {
			description = "SAM9G15-EK Flattened Device Tree blob";
			data = /incbin/("./at91sam9g15ek.dtb");
			type = "flat_dt";
			arch = "arm";
			compression = "none";
			load = <0x23000000>;
			hash-1 {
				algo = "crc32";
			};
			hash-2 {
				algo = "sha1";
			};
		};

		sam9g25ek_fdt {
			description = "SAM9G25-EK Flattened Device Tree blob";
			data = /incbin/("./at91sam9g25ek.dtb");
			type = "flat_dt";
			arch = "arm";
			compression = "none";
			load = <0x23010000>;
			hash-1 {
				algo = "crc32";
			};
			hash-2 {
				algo = "sha1";
			};
		};

		sam9g35ek_fdt {
			description = "SAM9G35-EK Flattened Device Tree blob";
			data = /incbin/("./at91sam9g35ek.dtb");
			type = "flat_dt";
			arch = "arm";
			compression = "none";
			load = <0x23020000>;
			hash-1 {
				algo = "crc32";
			};
			hash-2 {
				algo = "sha1";
			};
		};

		sam9x25ek_fdt {
			description = "SAM9X25-EK Flattened Device Tree blob";
			data = /incbin/("./at91sam9x25ek.dtb");
			type = "flat_dt";
			arch = "arm";
			compression = "none";
			load = <0x23030000>;
			hash-1 {
				algo = "crc32";
			};
			hash-2 {
				algo = "sha1";
			};
		};

		sam9x35ek_fdt {
			description = "SAM9X35-EK Flattened Device Tree blob";
			data = /incbin/("./at91sam9x35ek.dtb");
			type = "flat_dt";
			arch = "arm";
			compression = "none";
			load = <0x23040000>;
			hash-1 {
				algo = "crc32";
			};
			hash-2 {
				algo = "sha1";
			};
		};
	};

	configurations {
		default = "sam9g35";

		sam9g15 {
			description = "Linux kernel and base FDT blob for SAM9G15-EK board";
			kernel = "kernel";
			fdt = "sam9g15ek_fdt";
		};

		sam9g25 {
			description = "Linux kernel and base FDT blob for SAM9G25-EK board";
			kernel = "kernel";
			fdt = "sam9g25ek_fdt";
		};

		sam9g35 {
			description = "Linux kernel and base FDT blob for SAM9G35-EK board";
			kernel = "kernel";
			fdt = "sam9g35ek_fdt";
		};

		sam9x25 {
			description = "Linux kernel and base FDT blob for SAM9X25-EK board";
			kernel = "kernel";
			fdt = "sam9x25ek_fdt";
		};

		sam9x35 {
			description = "Linux kernel and base FDT blob for SAM9X35-EK board";
			kernel = "kernel";
			fdt = "sam9x35ek_fdt";
		};
	};
};
```

## mpfs_discovery_kit.its
```
// SPDX-License-Identifier: (GPL-2.0+ OR MIT)
/*
 * Flattened Image Tree file for MPFS Discovery Kit
 *
 * Copyright (C) 2025 Microchip Technology Inc. and its subsidiaries.
 * Author: Garo Janir <garo.janir@microchip.com>
 *
 */

/dts-v1/;

/ {
	description = "U-Boot fitImage for the MPFS";
	#address-cells = <2>;

		images {
			kernel {
				description = "Linux kernel";
				data = /incbin/("./Image.gz");
				type = "kernel";
				arch = "riscv";
				os = "linux";
				compression = "gzip";
				load = <0x80200000>;
				entry = <0x80200000>;
				hash-1 {
					algo = "sha256";
				};
			};
			base_fdt {
				description = "Flattened Device Tree blob";
				data = /incbin/("./dts/microchip/mpfs-disco-kit.dtb");
				type = "flat_dt";
				arch = "riscv";
				compression = "none";
				load = <0x8a000000>;
				hash-1 {
					algo = "sha256";
				};
			};

		};

		configurations {
			default = "kernel_dtb";
			kernel_dtb {
				description = "1 Linux kernel, FDT blob";
				kernel = "kernel";
				fdt = "base_fdt";
			};

			base_dtb {
				description = "Base FDT blob for MPFS Discovery Kit";
				fdt = "base_fdt";
			};
		};
};
```

## mpfs_icicle.its
```
// SPDX-License-Identifier: (GPL-2.0+ OR MIT)
/*
 * Flattened Image Tree file for Icicle Kit
 *
 * Copyright (C) 2022 Microchip Technology Inc. and its subsidiaries.
 * Author: Conor Dooley <conor.dooley@microchip.com>
 *
 */

/dts-v1/;

/ {
	description = "U-Boot fitImage for the MPFS";
	#address-cells = <2>;

		images {
			kernel {
				description = "Linux kernel";
				data = /incbin/("./Image.gz");
				type = "kernel";
				arch = "riscv";
				os = "linux";
				compression = "gzip";
				load = <0x80200000>;
				entry = <0x80200000>;
				hash-1 {
					algo = "sha256";
				};
			};
			fdt-mpfs-icicle-kit.dtb {
				description = "Flattened Device Tree blob";
				data = /incbin/("./dts/microchip/mpfs-icicle-kit.dtb");
				type = "flat_dt";
				arch = "riscv";
				compression = "none";
				load = <0x8a000000>;
				hash-1 {
					algo = "sha256";
				};
			};
			fdt-mpfs-icicle-kit-prod.dtb {
				description = "Flattened Device Tree blob";
				data = /incbin/("./dts/microchip/mpfs-icicle-kit-prod.dtb");
				type = "flat_dt";
				arch = "riscv";
				compression = "none";
				load = <0x8a000000>;
				hash-1 {
					algo = "sha256";
				};
			};
			fdt-mpfs-icicle-rpi-sense-hat.dtbo {
				description = "Device Tree blob RPI Sense Hat";
				data = /incbin/("./mpfs_icicle/mpfs_icicle_rpi_sense_hat.dtbo");
				type = "flat_dt";
				arch = "riscv";
				compression = "none";
				load = <0x8a080000>;
				hash-1 {
					algo = "sha256";
				};
			};
			fdt-mpfs-icicle-flash5-click.dtbo {
				description = "Device Tree blob Flash 5 Click";
				data = /incbin/("./mpfs_icicle/mpfs_icicle_flash5_click.dtbo");
				type = "flat_dt";
				arch = "riscv";
				compression = "none";
				load = <0x8a090000>;
				hash-1 {
					algo = "sha256";
				};
			};
			fdt-mpfs-icicle-pmod-sf3.dtbo {
				description = "Device Tree blob Pmod SF3";
				data = /incbin/("./mpfs_icicle/mpfs_icicle_pmod_sf3.dtbo");
				type = "flat_dt";
				arch = "riscv";
				compression = "none";
				load = <0x8a0a0000>;
				hash-1 {
					algo = "sha256";
				};
			};
			fdt-mpfs-icicle-amp.dtbo {
				description = "Device Tree blob for AMP";
				data = /incbin/("./mpfs_icicle/mpfs_icicle_amp.dtbo");
				type = "flat_dt";
				arch = "riscv";
				compression = "none";
				load = <0x8a0b0000>;
				hash-1 {
					algo = "sha256";
				};
			};
			fdt-mpfs-icicle-cpu-opp.dtbo {
				description = "Device Tree blob for CPU Operating Points";
				data = /incbin/("./mpfs_icicle/mpfs_icicle_cpu_opp.dtbo");
				type = "flat_dt";
				arch = "riscv";
				compression = "none";
				load = <0x8a0c0000>;
				hash-1 {
					algo = "sha256";
				};
			};
		};

		configurations {
			default = "conf-microchip,mpfs-icicle-kit-prod";
			conf-microchip,mpfs-icicle-kit {
				description = "1 Linux kernel, FDT blob";
				kernel = "kernel";
				fdt = "fdt-mpfs-icicle-kit.dtb";
			};

			conf-microchip,mpfs-icicle-kit-prod {
				description = "1 Linux kernel, FDT blob";
				kernel = "kernel";
				fdt = "fdt-mpfs-icicle-kit-prod.dtb";
			};

			conf-microchip,mpfs-icicle-rpi-sense-hat {
				description = "FDT overlay blob for RPI Sense Hat";
				fdt = "fdt-mpfs-icicle-rpi-sense-hat.dtbo";
			};

			conf-microchip,mpfs-icicle-flash5-click {
				description = "FDT overlay blob for Flash 5 Click";
				fdt = "fdt-mpfs-icicle-flash5-click.dtbo";
			};

			conf-microchip,mpfs-icicle-pmod-sf3 {
				description = "FDT overlay blob for Pmod SF3";
				fdt = "fdt-mpfs-icicle-pmod-sf3.dtbo";
			};

			conf-microchip,mpfs-icicle-amp {
				description = "FDT overlay blob for AMP";
				fdt = "fdt-mpfs-icicle-amp.dtbo";
			};

			conf-microchip,mpfs-icicle-cpu-opp {
				description = "FDT overlay blob for CPU Operating Points";
				fdt = "fdt-mpfs-icicle-cpu-opp.dtbo";
			};

			conf-microchip,fdt-mpfs-icicle-kit.dtb {
				description = "Base FDT blob for MPFS Icicle board";
				fdt = "fdt-mpfs-icicle-kit.dtb";
			};

			conf-microchip,fdt-mpfs-icicle-kit-prod.dtb {
				description = "Base FDT blob for MPFS Icicle Production board";
				fdt = "fdt-mpfs-icicle-kit-prod.dtb";
			};
		};
};
```

## mpfs_icicle_amp.its
```
// SPDX-License-Identifier: (GPL-2.0+ OR MIT)
/*
 * Flattened Image Tree file for Icicle Kit AMP
 *
 * Copyright (C) 2022 Microchip Technology Inc. and its subsidiaries.
 * Author: Jamie Gibbons <jamie.gibbons@microchip.com>
 *
 */

/dts-v1/;

/ {
	description = "U-Boot fitImage for the MPFS AMP";
	#address-cells = <2>;

		images {
			kernel {
				description = "Linux kernel";
				data = /incbin/("./Image.gz");
				type = "kernel";
				arch = "riscv";
				os = "linux";
				compression = "gzip";
				load = <0x80200000>;
				entry = <0x80200000>;
				hash-1 {
					algo = "sha256";
				};
			};
			base_fdt {
				description = "Flattened Device Tree blob";
				data = /incbin/("./dts/microchip/mpfs-icicle-kit-context-a.dtb");
				type = "flat_dt";
				arch = "riscv";
				compression = "none";
				load = <0x8a000000>;
				hash-1 {
					algo = "sha256";
				};
			};
			fdt_rpi {
				description = "Device Tree blob RPI Sense Hat";
				data = /incbin/("./mpfs_icicle_amp/mpfs_icicle_rpi_sense_hat.dtbo");
				type = "flat_dt";
				arch = "riscv";
				compression = "none";
				load = <0x8a080000>;
				hash-1 {
					algo = "sha256";
				};
			};
			fdt_f5c {
				description = "Device Tree blob Flash 5 Click";
				data = /incbin/("./mpfs_icicle_amp/mpfs_icicle_flash5_click.dtbo");
				type = "flat_dt";
				arch = "riscv";
				compression = "none";
				load = <0x8a090000>;
				hash-1 {
					algo = "sha256";
				};
			};
			fdt_pmod3 {
				description = "Device Tree blob Pmod SF3";
				data = /incbin/("./mpfs_icicle_amp/mpfs_icicle_pmod_sf3.dtbo");
				type = "flat_dt";
				arch = "riscv";
				compression = "none";
				load = <0x8a0a0000>;
				hash-1 {
					algo = "sha256";
				};
			};
		};

		configurations {
			default = "kernel_dtb";
			kernel_dtb {
				description = "Linux kernel, FDT blob";
				kernel = "kernel";
				fdt = "base_fdt";
			};

			base_dtb {
				description = "Base FDT blob for MPFS Icicle board";
				fdt = "base_fdt";
			};

			rpi {
				description = "FDT overlay blob for RPI Sense Hat";
				fdt = "fdt_rpi";
			};

			f5c {
				description = "FDT overlay blob for Flash 5 Click";
				fdt = "fdt_f5c";
			};

			pmod3 {
				description = "FDT overlay blob for Pmod SF3";
				fdt = "fdt_pmod3";
			};
		};
};
```

## mpfs_video.its
```
// SPDX-License-Identifier: (GPL-2.0+ OR MIT)
/*
 * Flattened Image Tree file for Mpfs Video Kit
 *
 * Copyright (C) 2022 Microchip Technology Inc. and its subsidiaries.
 * Author: shravan chippa <shravan.chippa@microchip.com>
 *
 */

/dts-v1/;

/ {
	description = "U-Boot fitImage for the MPFS";
	#address-cells = <2>;

		images {
			kernel {
				description = "Linux kernel";
				data = /incbin/("./Image.gz");
				type = "kernel";
				arch = "riscv";
				os = "linux";
				compression = "gzip";
				load = <0x80200000>;
				entry = <0x80200000>;
				hash-1 {
					algo = "sha256";
				};
			};
			base_fdt {
				description = "Flattened Device Tree blob";
				data = /incbin/("./dts/microchip/mpfs-video-kit.dtb");
				type = "flat_dt";
				arch = "riscv";
				compression = "none";
				load = <0x8a000000>;
				hash-1 {
					algo = "sha256";
				};
			};
			fdt_h_264 {
				description = "Device Tree mpfs_h264 dtbo";
				data = /incbin/("./mpfs_video/mpfs_h264.dtbo");
				type = "flat_dt";
				arch = "riscv";
				compression = "none";
				load = <0x8a080000>;
				hash-1 {
					algo = "sha256";
				};
			};
			fdt_mpfs_video_bayer {
				description = "Device Tree mpfs video bayer dtbo";
				data = /incbin/("./mpfs_video/mpfs_video_bayer.dtbo");
				type = "flat_dt";
				arch = "riscv";
				compression = "none";
				load = <0x8a090000>;
				hash-1 {
					algo = "sha256";
				};
			};
		};

		configurations {
			default = "kernel_dtb";
			kernel_dtb {
				description = "1 Linux kernel, FDT blob";
				kernel = "kernel";
				fdt = "base_fdt";
			};

			base_dtb {
				description = "Base FDT blob for MPFS Video board";
				fdt = "base_fdt";
			};

			h_264 {
				description = "FDT overlay blob for H.264";
				fdt = "fdt_h_264";
			};

			mpfs_video_bayer {
				description = "FDT overlay blob for video bayer";
				fdt = "fdt_mpfs_video_bayer";
			};
		};
};
```
