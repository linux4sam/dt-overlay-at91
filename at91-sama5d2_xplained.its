## sam9x75_curiosity_pro.its
```
// SPDX-License-Identifier: (GPL-2.0+ OR MIT)
/*
 * Flattened Image Tree file for SAM9X75-Curiosity-Pro board
 *
 * Copyright (C) 2026 Microchip Technology Inc. and its subsidiaries
 *
 * Author: Ryan Wanner <ryan.wanner@microchip.com>
 */
/dts-v1/;

/ {
	description = "Microchip SAM9X75-Curiosity-Pro FIT Image";
	#address-cells = <1>;

	images {
		kernel {
			description = "Linux4SAM Linux kernel";
			data = /incbin/("./zImage");
			type = "kernel";
			arch = "arm";
			os = "linux";
			compression = "none";
			load = <0x22000000>;
			entry = <0x22000000>;
			hash-1 {
				algo = "crc32";
			};
			hash-2 {
				algo = "sha1";
			};
		};

		base_fdt {
			description = "SAM9X75-Curiosity-Pro Flattened Device Tree blob";
			data = /incbin/("./at91-sam9x75_curiosity_pro.dtb");
			type = "flat_dt";
			arch = "arm";
			compression = "none";
			load = <0x23000000>;
			hash-1 {
				algo = "crc32";
			};
			hash-2 {
				algo = "sha1";
			};
		};

		fdt_isc_imx219 {
			description = "Device Tree blob ISC IMX219 overlay";
			data = /incbin/("./sam9x75_curiosity_pro/sam9x75_curiosity_pro_isc_imx219.dtbo");
			type = "flat_dt";
			arch = "arm";
			compression = "none";
			load = <0x23100000>;
			hash-1 {
				algo = "crc32";
			};
			hash-2 {
				algo = "sha1";
			};
		};

		fdt_lvds_panel {
			description = "Device Tree blob for AC69T88A LVDS Display Panel";
			data = /incbin/("./sam9x75_curiosity_pro/sam9x75_curiosity_pro_lvds_display.dtbo");
			type = "flat_dt";
			arch = "arm";
			compression = "none";
			load = <0x23110000>;
			hash-1 {
				algo = "crc32";
			};
			hash-2 {
				algo = "sha1";
			};
		};

		fdt_lvds_panel_newvision {
			description = "Device Tree blob for New Vision Display Panel";
			data = /incbin/("./sam9x75_curiosity_pro/sam9x75_curiosity_pro_lvds_newvision_display.dtbo");
			type = "flat_dt";
			arch = "arm";
			compression = "none";
			load = <0x23110000>;
			hash-1 {
				algo = "crc32";
			};
			hash-2 {
				algo = "sha1";
			};
		};

		fdt_gmac_rmii_phy {
			description = "Device Tree blob for Generic RMII PHY overlay";
			data = /incbin/("./sam9x75_curiosity_pro/sam9x75_curiosity_pro_gmac_rmii-phy.dtbo");
			type = "flat_dt";
			arch = "arm";
			compression = "none";
			load = <0x23120000>;
			hash-1 {
				algo = "crc32";
			};
			hash-2 {
				algo = "sha1";
			};
		};

		fdt_gmac_rgmii_phy {
			description = "Device Tree blob for Generic RGMII PHY overlay";
			data = /incbin/("./sam9x75_curiosity_pro/sam9x75_curiosity_pro_gmac_rgmii-phy.dtbo");
			type = "flat_dt";
			arch = "arm";
			compression = "none";
			load = <0x23120000>;
			hash-1 {
				algo = "crc32";
			};
			hash-2 {
				algo = "sha1";
			};
		};

		fdt_gmac_lan9646 {
			description = "Device Tree blob for LAN9646 RGMII switch overlay";
			data = /incbin/("./sam9x75_curiosity_pro/sam9x75_curiosity_pro_gmac_lan9646.dtbo");
			type = "flat_dt";
			arch = "arm";
			compression = "none";
			load = <0x23120000>;
			hash-1 {
				algo = "crc32";
			};
			hash-2 {
				algo = "sha1";
			};
		};

		fdt_gmac_ksz8795 {
			description = "Device Tree blob for KSZ8795 RMII switch overlay";
			data = /incbin/("./sam9x75_curiosity_pro/sam9x75_curiosity_pro_gmac_ksz8795.dtbo");
			type = "flat_dt";
			arch = "arm";
			compression = "none";
			load = <0x23120000>;
			hash-1 {
				algo = "crc32";
			};
			hash-2 {
				algo = "sha1";
			};
		};

		fdt_gmac_ksz8895 {
			description = "Device Tree blob for KSZ8895 RMII switch overlay";
			data = /incbin/("./sam9x75_curiosity_pro/sam9x75_curiosity_pro_gmac_ksz8895.dtbo");
			type = "flat_dt";
			arch = "arm";
			compression = "none";
			load = <0x23120000>;
			hash-1 {
				algo = "crc32";
			};
			hash-2 {
				algo = "sha1";
			};
		};

		fdt_gmac_ksz9477 {
			description = "Device Tree blob for KSZ9477 RGMII switch overlay";
			data = /incbin/("./sam9x75_curiosity_pro/sam9x75_curiosity_pro_gmac_ksz9477.dtbo");
			type = "flat_dt";
			arch = "arm";
			compression = "none";
			load = <0x23120000>;
			hash-1 {
				algo = "crc32";
			};
			hash-2 {
				algo = "sha1";
			};
		};

		fdt_gmac_ksz9563 {
			description = "Device Tree blob for KSZ9563 RGMII switch overlay";
			data = /incbin/("./sam9x75_curiosity_pro/sam9x75_curiosity_pro_gmac_ksz9563.dtbo");
			type = "flat_dt";
			arch = "arm";
			compression = "none";
			load = <0x23120000>;
			hash-1 {
				algo = "crc32";
			};
			hash-2 {
				algo = "sha1";
			};
		};

		fdt_i2s_proto {
			description = "Device Tree blob PROTO Audio board overlay";
			data = /incbin/("./sam9x75_curiosity_pro/sam9x75_curiosity_pro_i2s_proto.dtbo");
			type = "flat_dt";
			arch = "arm";
			compression = "none";
			load = <0x23130000>;
			hash-1 {
				algo = "crc32";
			};
			hash-2 {
				algo = "sha1";
			};
		};

		fdt_mipi_panel {
			description = "Device Tree blob for AC40T08A MPU32 MIPI Display Panel";
			data = /incbin/("./sam9x75_curiosity_pro/sam9x75_curiosity_pro_mipi_display.dtbo");
			type = "flat_dt";
			arch = "arm";
			compression = "none";
			load = <0x23140000>;
			hash-1 {
				algo = "crc32";
			};
			hash-2 {
				algo = "sha1";
			};
		};

		fdt_pwm {
			description = "Device Tree blob for PWM signals";
			data = /incbin/("./sam9x75_curiosity_pro/sam9x75_curiosity_pro_pwm.dtbo");
			type = "flat_dt";
			arch = "arm";
			compression = "none";
			load = <0x23150000>;
			hash-1 {
				algo = "crc32";
			};
			hash-2 {
				algo = "sha1";
			};
		};

		fdt_spi_click {
			description = "Device Tree blob at25ff321a spi flash clickboard overlay";
			data = /incbin/("./sam9x75_curiosity_pro/sam9x75_curiosity_pro_at25ff321a_click.dtbo");
			type = "flat_dt";
			arch = "arm";
			compression = "none";
			load = <0x23160000>;
			hash-1 {
				algo = "crc32";
			};
			hash-2 {
				algo = "sha1";
			};
		};
	};

	configurations {
		default = "kernel_dtb";

		kernel_dtb {
			description = "Linux kernel and base FDT blob for SAM9X75-Curiosity-Pro board";
			kernel = "kernel";
			fdt = "base_fdt";
		};

		base_dtb {
			description = "Base FDT blob for SAM9X75-Curiosity-Pro board";
			fdt = "base_fdt";
		};

		imx219 {
			description = "FDT overlay blob for ISC IMX219 sensor";
			fdt = "fdt_isc_imx219";
		};

		lvds {
			description = "FDT overlay blob for AC69T88A LVDS Display Panel";
			fdt = "fdt_lvds_panel";
		};

		lvds_newvision {
			description = "FDT overlay blob for New Vision LVDS Display Panel";
			fdt = "fdt_lvds_panel_newvision";
		};

		rmii-phy {
			description = "FDT overlay blob for Single-port RMII PHY Daughter Card";
			fdt = "fdt_gmac_rmii_phy";
		};

		rgmii-phy {
			description = "FDT overlay blob for Single-port RGMII PHY Daughter Card";
			fdt = "fdt_gmac_rgmii_phy";
		};

		ksz9131 {
			description = "FDT overlay blob for KSZ9131 RGMII PHY Daughter Card";
			fdt = "fdt_gmac_rgmii_phy";
		};

		lan8840 {
			description = "FDT overlay blob for LAN8840 RGMII PHY Daughter Card";
			fdt = "fdt_gmac_rgmii_phy";
		};

		vsc8541 {
			description = "FDT overlay blob for VSC8541 RGMII PHY EDS2 Daughter Card";
			fdt = "fdt_gmac_rgmii_phy";
		};

		lan9646 {
			description = "FDT overlay blob for LAN9646 RGMII switch Daughter Card";
			fdt = "fdt_gmac_lan9646";
		};

		ksz8795 {
			description = "FDT overlay blob for KSZ8795 RGMII switch Daughter Card";
			fdt = "fdt_gmac_ksz8795";
		};

		ksz8895 {
			description = "FDT overlay blob for KSZ8895 RMII switch Daughter Card";
			fdt = "fdt_gmac_ksz8895";
		};

		ksz9477 {
			description = "FDT overlay blob for KSZ9477 RGMII switch Daughter Card";
			fdt = "fdt_gmac_ksz9477";
		};

		ksz9563 {
			description = "FDT overlay blob for KSZ9563 RGMII switch Daughter Card";
			fdt = "fdt_gmac_ksz9563";
		};

		i2s_proto {
			description = "FDT overlay blob for I2S PROTO audio board";
			fdt = "fdt_i2s_proto";
		};

		mipi {
			description = "FDT overlay blob for AC40T08A MPU32 MIPI Display Panel";
			fdt = "fdt_mipi_panel";
		};

		pwm {
			description = "FDT overlay blob for PWM";
			fdt = "fdt_pwm";
		};

		spi_click {
			description = "FDT overlay blob for at25ff321a spi flash clickboard";
			fdt = "fdt_spi_click";
		};
	};
};
```

## sam9x75eb.its
```
// SPDX-License-Identifier: (GPL-2.0+ OR MIT)
/*
 * Flattened Image Tree file for SAM9X75-EB board
 *
 * Copyright (C) 2022 Microchip Technology Inc. and its subsidiaries
 *
 * Author: Varshini Rajendran <Varshini.Rajendran@microchip.com>
 */
/dts-v1/;

/ {
	description = "Microchip SAM9X75-EB FIT Image";
	#address-cells = <1>;

	images {
		kernel {
			description = "Linux4SAM Linux kernel";
			data = /incbin/("./zImage");
			type = "kernel";
			arch = "arm";
			os = "linux";
			compression = "none";
			load = <0x22000000>;
			entry = <0x22000000>;
			hash-1 {
				algo = "crc32";
			};
			hash-2 {
				algo = "sha1";
			};
		};

		base_fdt {
			description = "SAM9X75-EB Flattened Device Tree blob";
			data = /incbin/("./at91-sam9x75eb.dtb");
			type = "flat_dt";
			arch = "arm";
			compression = "none";
			load = <0x23000000>;
			hash-1 {
				algo = "crc32";
			};
			hash-2 {
				algo = "sha1";
			};
		};

		fdt_isc_imx219 {
			description = "Device Tree blob ISC IMX219 overlay";
			data = /incbin/("./sam9x75eb/sam9x75eb_isc_imx219.dtbo");
			type = "flat_dt";
			arch = "arm";
			compression = "none";
			load = <0x23100000>;
			hash-1 {
				algo = "crc32";
			};
			hash-2 {
				algo = "sha1";
			};
		};

		fdt_lvds_panel {
			description = "Device Tree blob for AC69T88A LVDS Display Panel";
			data = /incbin/("./sam9x75eb/sam9x75eb_lvds_display.dtbo");
			type = "flat_dt";
			arch = "arm";
			compression = "none";
			load = <0x23110000>;
			hash-1 {
				algo = "crc32";
			};
			hash-2 {
				algo = "sha1";
			};
		};
	};

	configurations {
		default = "kernel_dtb";

		kernel_dtb {
			description = "Linux kernel and base FDT blob for SAM9X75-EB board";
			kernel = "kernel";
			fdt = "base_fdt";
		};

		base_dtb {
			description = "Base FDT blob for SAM9X75-EB board";
			fdt = "base_fdt";
		};

		imx219 {
			description = "FDT overlay blob for ISC IMX219 sensor";
			fdt = "fdt_isc_imx219";
		};

		lvds {
			description = "FDT overlay blob for AC69T88A LVDS Display Panel";
			fdt = "fdt_lvds_panel";
		};
	};
};
```
