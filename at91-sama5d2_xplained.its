## sama5d27_som1_ek.its
```
// SPDX-License-Identifier: (GPL-2.0+ OR MIT)
/*
 * Flattened Image Tree file for SAMA5D27-SOM1-EK1 board
 *
 * Copyright (C) 2018 Microchip Technology, Inc.
 * Author: Cristian Birsan <cristian.birsan@microchip.com>
 *
 */
/dts-v1/;

/ {
	description = "Microchip SAMA5D27 SOM1 EK FIT Image";
	#address-cells = <1>;

	images {
		kernel {
			description = "Linux4SAM Linux kernel";
			data = /incbin/("./zImage");
			type = "kernel";
			arch = "arm";
			os = "linux";
			compression = "none";
			load = <0x22000000>;
			entry = <0x22000000>;
			hash-1 {
				algo = "crc32";
			};
			hash-2 {
				algo = "sha1";
			};
		};

		base_fdt {
			description = "Flattened Device Tree blob";
			data = /incbin/("./at91-sama5d27_som1_ek.dtb");
			type = "flat_dt";
			arch = "arm";
			compression = "none";
			load = <0x23000000>;
			hash-1 {
				algo = "crc32";
			};
			hash-2 {
				algo = "sha1";
			};
		};

		fdt_pda4 {
			description = "Device Tree blob pda4300 overlay";
			data = /incbin/("./sama5d27_som1_ek/sama5d27_som1_ek_pda4.dtbo");
			type = "flat_dt";
			arch = "arm";
			compression = "none";
			load = <0x23130000>;
			hash-1 {
				algo = "crc32";
			};
			hash-2 {
				algo = "sha1";
			};
		};

		fdt_pda5 {
			description = "Device Tree blob pda5000 overlay";
			data = /incbin/("./sama5d27_som1_ek/sama5d27_som1_ek_pda5.dtbo");
			type = "flat_dt";
			arch = "arm";
			compression = "none";
			load = <0x23140000>;
			hash-1 {
				algo = "crc32";
			};
			hash-2 {
				algo = "sha1";
			};
		};

		fdt_pda7 {
			description = "Device Tree blob pda7000 overlay";
			data = /incbin/("./sama5d27_som1_ek/sama5d27_som1_ek_pda7.dtbo");
			type = "flat_dt";
			arch = "arm";
			compression = "none";
			load = <0x23150000>;
			hash-1 {
				algo = "crc32";
			};
			hash-2 {
				algo = "sha1";
			};
		};

		fdt_pda7b {
			description = "Device Tree blob pda7000b overlay";
			data = /incbin/("./sama5d27_som1_ek/sama5d27_som1_ek_pda7b.dtbo");
			type = "flat_dt";
			arch = "arm";
			compression = "none";
			load = <0x23160000>;
			hash-1 {
				algo = "crc32";
			};
			hash-2 {
				algo = "sha1";
			};
		};

		fdt_ov5640 {
			description = "Device Tree blob ov5640 overlay";
			data = /incbin/("./sama5d27_som1_ek/sama5d27_som1_ek_ov5640.dtbo");
			type = "flat_dt";
			arch = "arm";
			compression = "none";
			load = <0x23170000>;
			hash-1 {
				algo = "crc32";
			};
			hash-2 {
				algo = "sha1";
			};
		};

		fdt_mt9v022 {
			description = "Device Tree blob MT9V022 overlay";
			data = /incbin/("./sama5d27_som1_ek/sama5d27_som1_ek_mt9v022.dtbo");
			type = "flat_dt";
			arch = "arm";
			compression = "none";
			load = <0x23180000>;
			hash-1 {
				algo = "crc32";
			};
			hash-2 {
				algo = "sha1";
			};
		};

                fdt_thermo5 {
                        description = "Device Tree blob Thermo5 Click overlay";
                        data = /incbin/("./sama5d27_som1_ek/sama5d27_som1_ek_thermo5.dtbo");
                        type = "flat_dt";
                        arch = "arm";
                        compression = "none";
                        load = <0x23190000>;
                        hash-1 {
                                algo = "crc32";
                        };
                        hash-2 {
                                algo = "sha1";
                        };
                };

		fdt_mcp2518fd_click1 {
			description = "Device Tree blob MCP2518FD Click overlay click 1";
			data = /incbin/("./sama5d27_som1_ek/sama5d27_som1_ek_mcp2518fd_click1.dtbo");
			type = "flat_dt";
			arch = "arm";
			compression = "none";
			load = <0x231A0000>;
			hash-1 {
			        algo = "crc32";
			};
			hash-2 {
			        algo = "sha1";
			};
		};

		fdt_mcp2518fd_click2 {
			description = "Device Tree blob MCP2518FD Click overlay click 2";
			data = /incbin/("./sama5d27_som1_ek/sama5d27_som1_ek_mcp2518fd_click2.dtbo");
			type = "flat_dt";
			arch = "arm";
			compression = "none";
			load = <0x231B0000>;
			hash-1 {
			        algo = "crc32";
			};
			hash-2 {
			        algo = "sha1";
			};
		};

		fdt_wilc_spi {
			description = "Device Tree blob WILC SPI overlay";
			data = /incbin/("./sama5d27_som1_ek/sama5d27_som1_ek_wilc_spi.dtbo");
			type = "flat_dt";
			arch = "arm";
			compression = "none";
			load = <0x231C0000>;
			hash-1 {
			        algo = "crc32";
			};
			hash-2 {
			        algo = "sha1";
			};
		};

		fdt_spi_click1 {
			description = "Device Tree blob at25ff321a spi flash clickboard overlay";
			data = /incbin/("./sama5d27_som1_ek/sama5d27_som1_ek_at25ff321a_click1.dtbo");
			type = "flat_dt";
			arch = "arm";
			compression = "none";
			load = <0x231D0000>;
			hash-1 {
				algo = "crc32";
			};
			hash-2 {
				algo = "sha1";
			};
		};
	};

	configurations {
		default = "kernel_dtb";

		kernel_dtb {
			description = "Linux kernel and base FDT blob for SAMA5D27_SOM1_EK board";
			kernel = "kernel";
			fdt = "base_fdt";
		};
		base_dtb {
			description = "FDT blob for base SAMA5D27_SOM1_EK board";
			fdt = "base_fdt";
		};

		mt9v022 {
			description = "FDT overlay blob for mt9v022 sensor";
			fdt = "fdt_mt9v022";
		};

		pda4 {
			description = "FDT overlay blob for PDA TM4300 screen";
			fdt = "fdt_pda4";
		};

		pda5 {
			description = "FDT overlay blob for PDA TM5000 screen";
			fdt = "fdt_pda5";
		};

		pda7 {
			description = "FDT overlay blob for PDA TM7000 screen";
			fdt = "fdt_pda7";
		};

		pda7b {
			description = "FDT overlay blob for PDA TM7000B screen";
			fdt = "fdt_pda7b";
		};

		ov5640 {
			description = "FDT overlay blob for ov5640 sensor";
			fdt = "fdt_ov5640";
		};

                thermo5 {
                        description = "FDT overlay blob for Thermo5 click";
                        fdt = "fdt_thermo5";
                };

		mcp2518fd_click1 {
			description = "FDT overlay blob for MCP2518FD click1";
			fdt = "fdt_mcp2518fd_click1";
		};

		mcp2518fd_click2 {
			description = "FDT overlay blob for MCP2518FD click2";
			fdt = "fdt_mcp2518fd_click2";
		};

		wilc_spi {
			description = "FDT overlay blob for WILC SPI devices";
			fdt = "fdt_wilc_spi";
		};

		spi_click1 {
			description = "FDT overlay blob for at25ff321a spi flash clickboard (1)";
			fdt = "fdt_spi_click1";
		};
	};
};
```

## sama5d27_wlsom1_ek.its
```
// SPDX-License-Identifier: (GPL-2.0+ OR MIT)
/*
 * Flattened Image Tree file for SAMA5D27 WLSOM1 EK
 *
 * Copyright (C) 2019 Microchip Technology, Inc.
 * Author: Eugen Hristev <eugen.hristev@microchip.com>
 *
 */
/dts-v1/;

/ {
	description = "Microchip SAMA5D27 WLSOM1 EK FIT Image";
	#address-cells = <1>;

	images {
		kernel {
			description = "Linux4SAM Linux kernel";
			data = /incbin/("./zImage");
			type = "kernel";
			arch = "arm";
			os = "linux";
			compression = "none";
			load = <0x22000000>;
			entry = <0x22000000>;
			hash-1 {
				algo = "crc32";
			};
			hash-2 {
				algo = "sha1";
			};
		};

		base_fdt {
			description = "Flattened Device Tree blob";
			data = /incbin/("./at91-sama5d27_wlsom1_ek.dtb");
			type = "flat_dt";
			arch = "arm";
			compression = "none";
			load = <0x23000000>;
			hash-1 {
				algo = "crc32";
			};
			hash-2 {
				algo = "sha1";
			};
		};

		fdt_isc {
			description = "Device Tree blob ISC overlay";
			data = /incbin/("./sama5d27_wlsom1_ek/sama5d27_wlsom1_ek_isc.dtbo");
			type = "flat_dt";
			arch = "arm";
			compression = "none";
			load = <0x23100000>;
			hash-1 {
				algo = "crc32";
			};
			hash-2 {
				algo = "sha1";
			};
		};

		fdt_ov7670 {
			description = "Device Tree blob Ov7670 overlay";
			data = /incbin/("./sama5d27_wlsom1_ek/sama5d27_wlsom1_ek_ov7670.dtbo");
			type = "flat_dt";
			arch = "arm";
			compression = "none";
			load = <0x23110000>;
			hash-1 {
				algo = "crc32";
			};
			hash-2 {
				algo = "sha1";
			};
		};

		fdt_ov7740 {
			description = "Device Tree blob OV7740 overlay";
			data = /incbin/("./sama5d27_wlsom1_ek/sama5d27_wlsom1_ek_ov7740.dtbo");
			type = "flat_dt";
			arch = "arm";
			compression = "none";
			load = <0x23120000>;
			hash-1 {
				algo = "crc32";
			};
			hash-2 {
				algo = "sha1";
			};
		};

		fdt_pda4 {
			description = "Device Tree blob pda4300 overlay";
			data = /incbin/("./sama5d27_wlsom1_ek/sama5d27_wlsom1_ek_pda4.dtbo");
			type = "flat_dt";
			arch = "arm";
			compression = "none";
			load = <0x23130000>;
			hash-1 {
				algo = "crc32";
			};
			hash-2 {
				algo = "sha1";
			};
		};

		fdt_pda5 {
			description = "Device Tree blob pda5000 overlay";
			data = /incbin/("./sama5d27_wlsom1_ek/sama5d27_wlsom1_ek_pda5.dtbo");
			type = "flat_dt";
			arch = "arm";
			compression = "none";
			load = <0x23140000>;
			hash-1 {
				algo = "crc32";
			};
			hash-2 {
				algo = "sha1";
			};
		};

		fdt_pda7 {
			description = "Device Tree blob pda7000 overlay";
			data = /incbin/("./sama5d27_wlsom1_ek/sama5d27_wlsom1_ek_pda7.dtbo");
			type = "flat_dt";
			arch = "arm";
			compression = "none";
			load = <0x23150000>;
			hash-1 {
				algo = "crc32";
			};
			hash-2 {
				algo = "sha1";
			};
		};

		fdt_pda7b {
			description = "Device Tree blob pda7000b overlay";
			data = /incbin/("./sama5d27_wlsom1_ek/sama5d27_wlsom1_ek_pda7b.dtbo");
			type = "flat_dt";
			arch = "arm";
			compression = "none";
			load = <0x23160000>;
			hash-1 {
				algo = "crc32";
			};
			hash-2 {
				algo = "sha1";
			};
		};

		fdt_ov5640 {
			description = "Device Tree blob OV5640 overlay";
			data = /incbin/("./sama5d27_wlsom1_ek/sama5d27_wlsom1_ek_ov5640.dtbo");
			type = "flat_dt";
			arch = "arm";
			compression = "none";
			load = <0x23190000>;
			hash-1 {
				algo = "crc32";
			};
			hash-2 {
				algo = "sha1";
			};
		};

		fdt_ptc {
			description = "Device Tree blob PTC overlay";
			data = /incbin/("./sama5d27_wlsom1_ek/sama5d27_wlsom1_ek_ptc.dtbo");
			type = "flat_dt";
			arch = "arm";
			compression = "none";
			load = <0x23170000>;
			hash-1 {
				algo = "crc32";
			};
			hash-2 {
				algo = "sha1";
			};
		};

		fdt_mt9v022 {
			description = "Device Tree blob MT9V022 overlay";
			data = /incbin/("./sama5d27_wlsom1_ek/sama5d27_wlsom1_ek_mt9v022.dtbo");
			type = "flat_dt";
			arch = "arm";
			compression = "none";
			load = <0x23200000>;
			hash-1 {
				algo = "crc32";
			};
			hash-2 {
				algo = "sha1";
			};
		};

		fdt_spi_click1 {
			description = "Device Tree blob at25ff321a spi flash clickboard overlay";
			data = /incbin/("./sama5d27_wlsom1_ek/sama5d27_wlsom1_ek_at25ff321a_click1.dtbo");
			type = "flat_dt";
			arch = "arm";
			compression = "none";
			load = <0x23210000>;
			hash-1 {
				algo = "crc32";
			};
			hash-2 {
				algo = "sha1";
			};
		};
	};

	configurations {
		default = "kernel_dtb";

		kernel_dtb {
			description = "Linux kernel and base FDT blob for SAMA5D27_WLSOM1_EK board";
			kernel = "kernel";
			fdt = "base_fdt";
		};
		base_dtb {
			description = "FDT blob for base SAMA5D27_WLSOM1_EK board";
			fdt = "base_fdt";
		};

		isc {
			description = "FDT overlay blob for isc";
			fdt = "fdt_isc";
		};

		ov7670 {
			description = "FDT overlay blob for ov7670 sensor";
			fdt = "fdt_ov7670";
		};

		ov7740 {
			description = "FDT overlay blob for ov7740 sensor";
			fdt = "fdt_ov7740";
		};

		ov5640 {
			description = "FDT overlay blob for ov5640 sensor";
			fdt = "fdt_ov5640";
		};

		mt9v022 {
			description = "FDT overlay blob for mt9v022 sensor";
			fdt = "fdt_mt9v022";
		};

		pda4 {
			description = "FDT overlay blob for PDA TM4300 screen";
			fdt = "fdt_pda4";
		};

		pda5 {
			description = "FDT overlay blob for PDA TM5000 screen";
			fdt = "fdt_pda5";
		};

		pda7 {
			description = "FDT overlay blob for PDA TM7000 screen";
			fdt = "fdt_pda7";
		};

		pda7b {
			description = "FDT overlay blob for PDA TM7000B screen";
			fdt = "fdt_pda7b";
		};

		ptc {
			description = "FDT overlay blob for PTC";
			fdt = "fdt_ptc";
		};

		spi_click1 {
			description = "FDT overlay blob for at25ff321a spi flash clickboard (1)";
			fdt = "fdt_spi_click1";
		};
	};
};
```

## sama5d29_curiosity.its
```
// SPDX-License-Identifier: (GPL-2.0+ OR MIT)
/*
 * Flattened Image Tree file for SAMA5D29 Curiosity board
 *
 * Copyright (C) 2023 Microchip Technology, Inc. and its subsidiaries
 * Author: Ciprian Abramov <ciprian.abramov@microchip.com>
 *
 */
/dts-v1/;

/ {
	description = "Microchip SAMA5D29-Curiosity FIT Image";
	#address-cells = <1>;

	images {
		kernel {
			description = "Linux4SAM Linux kernel";
			data = /incbin/("./zImage");
			type = "kernel";
			arch = "arm";
			os = "linux";
			compression = "none";
			load = <0x22000000>;
			entry = <0x22000000>;
			hash-1 {
				algo = "crc32";
			};
			hash-2 {
				algo = "sha1";
			};
		};

		base_fdt {
			description = "Flattened Device Tree blob";
			data = /incbin/("./at91-sama5d29_curiosity.dtb");
			type = "flat_dt";
			arch = "arm";
			compression = "none";
			load = <0x23000000>;
			hash-1 {
				algo = "crc32";
			};
			hash-2 {
				algo = "sha1";
			};
		};

		fdt_pda4 {
			description = "Device Tree blob TM4000 overlay";
			data = /incbin/("./sama5d29_curiosity/sama5d29_curiosity_pda4.dtbo");
			type = "flat_dt";
			arch = "arm";
			compression = "none";
			load = <0x23100000>;
			hash-1 {
				algo = "crc32";
			};
			hash-2 {
				algo = "sha1";
			};
		};

		fdt_pda5 {
			description = "Device Tree blob TM5000 overlay";
			data = /incbin/("./sama5d29_curiosity/sama5d29_curiosity_pda5.dtbo");
			type = "flat_dt";
			arch = "arm";
			compression = "none";
			load = <0x23110000>;
			hash-1 {
				algo = "crc32";
			};
			hash-2 {
				algo = "sha1";
			};
		};

		fdt_pda7 {
			description = "Device Tree blob TM7000 overlay";
			data = /incbin/("./sama5d29_curiosity/sama5d29_curiosity_pda7.dtbo");
			type = "flat_dt";
			arch = "arm";
			compression = "none";
			load = <0x23120000>;
			hash-1 {
				algo = "crc32";
			};
			hash-2 {
				algo = "sha1";
			};
		};

		fdt_pda7b {
			description = "Device Tree blob TM7000B overlay";
			data = /incbin/("./sama5d29_curiosity/sama5d29_curiosity_pda7b.dtbo");
			type = "flat_dt";
			arch = "arm";
			compression = "none";
			load = <0x23130000>;
			hash-1 {
				algo = "crc32";
			};
			hash-2 {
				algo = "sha1";
			};
		};

		fdt_lan8720a {
			description = "Device Tree blob LAN8720A overlay";
			data = /incbin/("./sama5d29_curiosity/sama5d29_curiosity_lan8720a.dtbo");
			type = "flat_dt";
			arch = "arm";
			compression = "none";
			load = <0x23140000>;
			hash-1 {
				algo = "crc32";
			};
			hash-2 {
				algo = "sha1";
			};
		};

		fdt_i2s0_proto {
			description = "Device Tree blob mikroe Audio Proto board overlay";
			data = /incbin/("./sama5d29_curiosity/sama5d29_curiosity_i2s0_proto.dtbo");
			type = "flat_dt";
			arch = "arm";
			compression = "none";
			load = <0x23150000>;
			hash-1 {
				algo = "crc32";
			};
			hash-2 {
				algo = "sha1";
			};
		};
	};

	configurations {
		default = "kernel_dtb";

		kernel_dtb {
			description = "Linux kernel and base FDT blob for SAMA5D29-Curiosity board";
			kernel = "kernel";
			fdt = "base_fdt";
		};

		base_dtb {
			description = "Base FDT blob for SAMA5D29-Curiosity board";
			fdt = "base_fdt";
		};

		pda4 {
			description = "FDT overlay blob for PDA TM4000 screen";
			fdt = "fdt_pda4";
		};

		pda5 {
			description = "FDT overlay blob for PDA TM5000 screen";
			fdt = "fdt_pda5";
		};

		pda7 {
			description = "FDT overlay blob for PDA TM7000 screen";
			fdt = "fdt_pda7";
		};

		pda7b {
			description = "FDT overlay blob for PDA TM7000B screen";
			fdt = "fdt_pda7b";
		};

		lan8720a {
			description = "FDT overlay blob for LAN8720A RMII adapter AC320004-3";
			fdt = "fdt_lan8720a";
		};

		i2s0_proto {
			description = "FDT overlay blob for mikroe Audio Proto board";
			fdt = "fdt_i2s0_proto";
		};
	};
};
```
