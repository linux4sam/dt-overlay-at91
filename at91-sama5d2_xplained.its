## sama7d65_curiosity.its
```
// SPDX-License-Identifier: (GPL-2.0+ OR MIT)
/*
 * Flattened Image Tree file for SAMA7D65-CURIOSITY board
 *
 * Copyright (C) 2024 Microchip Technology Inc. and its subsidiaries
 *
 * Author: Romain Sioen <romain.sioen@microchip.com>
 */
/dts-v1/;

/ {
	description = "Microchip SAMA7D65-CURIOSITY FIT Image";
	#address-cells = <1>;

	images {
		kernel {
			description = "Linux4SAM Linux kernel";
			data = /incbin/("./zImage");
			type = "kernel";
			arch = "arm";
			os = "linux";
			compression = "none";
			load = <0x62000000>;
			entry = <0x62000000>;
			hash-1 {
				algo = "crc32";
			};
			hash-2 {
				algo = "sha1";
			};
		};

		base_fdt {
			description = "SAMA7D65-CURIOSITY Flattened Device Tree blob";
			data = /incbin/("./at91-sama7d65_curiosity.dtb");
			type = "flat_dt";
			arch = "arm";
			compression = "none";
			load = <0x61000000>;
			hash-1 {
				algo = "crc32";
			};
			hash-2 {
				algo = "sha1";
			};
		};

		fdt_spi_click1 {
			description = "Device Tree blob at25ff321a spi flash clickboard overlay";
			data = /incbin/("./sama7d65_curiosity/sama7d65_curiosity_at25ff321a_click1.dtbo");
			type = "flat_dt";
			arch = "arm";
			compression = "none";
			load = <0x61100000>;
			hash-1 {
				algo = "crc32";
			};
			hash-2 {
				algo = "sha1";
			};
		};

		fdt_pwm {
			description = "Device Tree blob pwm overlay";
			data = /incbin/("./sama7d65_curiosity/sama7d65_curiosity_pwm.dtbo");
			type = "flat_dt";
			arch = "arm";
			compression = "none";
			load = <0x61200000>;
			hash-1 {
				algo = "crc32";
			};
			hash-2 {
				algo = "sha1";
			};
		};

		fdt_mipi {
			description = "Device Tree blob mipi display overlay";
			data = /incbin/("./sama7d65_curiosity/sama7d65_curiosity_mipi.dtbo");
			type = "flat_dt";
			arch = "arm";
			compression = "none";
			load = <0x61300000>;
			hash-1 {
				algo = "crc32";
			};
			hash-2 {
				algo = "sha1";
			};
		};

		fdt_lvds {
			description = "Device Tree blob lvds display overlay";
			data = /incbin/("./sama7d65_curiosity/sama7d65_curiosity_lvds.dtbo");
			type = "flat_dt";
			arch = "arm";
			compression = "none";
			load = <0x61300000>;
			hash-1 {
				algo = "crc32";
			};
			hash-2 {
				algo = "sha1";
			};
		};

		fdt_lvds_newvision {
			description = "Device Tree blob New Vision 10.1 inch display panel overlay";
			data = /incbin/("./sama7d65_curiosity/sama7d65_curiosity_lvds_newvision.dtbo");
			type = "flat_dt";
			arch = "arm";
			compression = "none";
			load = <0x61300000>;
			hash-1 {
				algo = "crc32";
			};
			hash-2 {
				algo = "sha1";
			};
		};

		fdt_tcb_pwm {
			description = "Device Tree blob tcb pwm overlay";
			data = /incbin/("./sama7d65_curiosity/sama7d65_curiosity_tcb_pwm.dtbo");
			type = "flat_dt";
			arch = "arm";
			compression = "none";
			load = <0x61400000>;
			hash-1 {
				algo = "crc32";
			};
			hash-2 {
				algo = "sha1";
			};
		};

		fdt_gmac_lan8840 {
			description = "Device Tree blob for a Gigabit PHY overlay";
			data = /incbin/("./sama7d65_curiosity/sama7d65_curiosity_gmac_lan8840.dtbo");
			type = "flat_dt";
			arch = "arm";
			compression = "none";
			load = <0x61500000>;
			hash-1 {
				algo = "crc32";
			};
			hash-2 {
				algo = "sha1";
			};
		};

		fdt_gmac_rmii-phy {
			description = "Device Tree blob for an RMII PHY overlay";
			data = /incbin/("./sama7d65_curiosity/sama7d65_curiosity_gmac_rmii-phy.dtbo");
			type = "flat_dt";
			arch = "arm";
			compression = "none";
			load = <0x61500000>;
			hash-1 {
				algo = "crc32";
			};
			hash-2 {
				algo = "sha1";
			};
		};

		fdt_gmac_ksz9477 {
			description = "Device Tree blob for KSZ9477 Gigabit switch overlay";
			data = /incbin/("./sama7d65_curiosity/sama7d65_curiosity_gmac_ksz9477.dtbo");
			type = "flat_dt";
			arch = "arm";
			compression = "none";
			load = <0x61500000>;
			hash-1 {
				algo = "crc32";
			};
			hash-2 {
				algo = "sha1";
			};
		};

		fdt_gmac_ksz9563 {
			description = "Device Tree blob for KSZ9563 Gigabit switch overlay";
			data = /incbin/("./sama7d65_curiosity/sama7d65_curiosity_gmac_ksz9563.dtbo");
			type = "flat_dt";
			arch = "arm";
			compression = "none";
			load = <0x61500000>;
			hash-1 {
				algo = "crc32";
			};
			hash-2 {
				algo = "sha1";
			};
		};

		fdt_gmac_ksz8795 {
			description = "Device Tree blob for KSZ8795 5-port switch overlay";
			data = /incbin/("./sama7d65_curiosity/sama7d65_curiosity_gmac_ksz8795.dtbo");
			type = "flat_dt";
			arch = "arm";
			compression = "none";
			load = <0x61500000>;
			hash-1 {
				algo = "crc32";
			};
			hash-2 {
				algo = "sha1";
			};
		};

		fdt_gmac_ksz8895 {
			description = "Device Tree blob for KSZ8895 5-port switch overlay";
			data = /incbin/("./sama7d65_curiosity/sama7d65_curiosity_gmac_ksz8895.dtbo");
			type = "flat_dt";
			arch = "arm";
			compression = "none";
			load = <0x61500000>;
			hash-1 {
				algo = "crc32";
			};
			hash-2 {
				algo = "sha1";
			};
		};

		fdt_gmac_lan9646 {
			description = "Device Tree blob for LAN9646 Gigabit switch overlay";
			data = /incbin/("./sama7d65_curiosity/sama7d65_curiosity_gmac_lan9646.dtbo");
			type = "flat_dt";
			arch = "arm";
			compression = "none";
			load = <0x61500000>;
			hash-1 {
				algo = "crc32";
			};
			hash-2 {
				algo = "sha1";
			};
		};

		fdt_gmac_lan8870 {
			description = "Device Tree blob for LAN8870 Gigabit PHY overlay";
			data = /incbin/("./sama7d65_curiosity/sama7d65_curiosity_gmac_lan8870.dtbo");
			type = "flat_dt";
			arch = "arm";
			compression = "none";
			load = <0x61500000>;
			hash-1 {
				algo = "crc32";
			};
			hash-2 {
				algo = "sha1";
			};
		};

		fdt_asrc_card_wm8731 {
			description = "Device Tree blob for ASRC card with WM8731 codec overlay";
			data = /incbin/("./sama7d65_curiosity/sama7d65_curiosity_asrc_wm8731.dtbo");
			type = "flat_dt";
			arch = "arm";
			compression = "none";
			load = <0x61600000>;
			hash-1 {
				algo = "crc32";
			};
			hash-2 {
				algo = "sha1";
			};
		};

		fdt_wm8731_proto {
			description = "Device Tree blob for WM8731 Mikroe PROTO codec board overlay";
			data = /incbin/("./sama7d65_curiosity/sama7d65_curiosity_wm8731_proto.dtbo");
			type = "flat_dt";
			arch = "arm";
			compression = "none";
			load = <0x61700000>;
			hash-1 {
				algo = "crc32";
			};
			hash-2 {
				algo = "sha1";
			};
		};
	};

	configurations {
		default = "kernel_dtb";

		kernel_dtb {
			description = "Linux kernel and base FDT blob for SAMA7D65-CURIOSITY board";
			kernel = "kernel";
			fdt = "base_fdt";
		};

		base_dtb {
			description = "Base FDT blob for SAMA7D65-CURIOSITY board";
			fdt = "base_fdt";
		};

		spi_click1 {
			description = "FDT overlay blob for at25ff321a spi flash clickboard (1)";
			fdt = "fdt_spi_click1";
		};

		pwm {
			description = "FDT overlay blob for pwms";
			fdt = "fdt_pwm";
		};

		mipi {
			description = "FDT overlay blob for mipi display";
			fdt = "fdt_mipi";
		};

		lvds {
			description = "FDT overlay blob for lvds display";
			fdt = "fdt_lvds";
		};

		lvds_newvision {
			description = "FDT overlay blob for 10.1 inch new vision lvds display";
			fdt = "fdt_lvds_newvision";
		};

		tcb_pwm {
			description = "FDT overlay blob for tcb pwm";
			fdt = "fdt_tcb_pwm";
		};

		rmii-phy {
			description = "FDT overlay blob for an RMII PHY";
			fdt = "fdt_gmac_rmii-phy";
		};

		lan8840 {
			description = "FDT overlay blob for a LAN8840 PHY";
			fdt = "fdt_gmac_lan8840";
		};

		ksz9131 {
			description = "FDT overlay blob for KSZ9131";
			fdt = "fdt_gmac_lan8840";
		};

		ksz9477 {
			description = "FDT overlay blob for KSZ9477";
			fdt = "fdt_gmac_ksz9477";
		};

		ksz9563 {
			description = "FDT overlay blob for KSZ9563";
			fdt = "fdt_gmac_ksz9563";
		};

		ksz8795 {
			description = "FDT overlay blob for KSZ8795";
			fdt = "fdt_gmac_ksz8795";
		};

		ksz8895 {
			description = "FDT overlay blob for KSZ8895";
			fdt = "fdt_gmac_ksz8895";
		};

		lan9646 {
			description = "FDT overlay blob for LAN9646";
			fdt = "fdt_gmac_lan9646";
		};

		lan8870 {
			description = "FDT overlay blob for LAN8870";
			fdt = "fdt_gmac_lan8870";
		};

		asrc_i2s1_wm8731 {
			description = "FDT overlay blob ASRC card with WM8731 codec";
			fdt = "fdt_asrc_card_wm8731";
		};

		i2s1_wm8731 {
			description = "FDT overlay blob with WM8731 Mikroe PROTO codec";
			fdt = "fdt_wm8731_proto";
		};
	};
};
```

## sama7d65_curiosity_pro.its
```
// SPDX-License-Identifier: (GPL-2.0+ OR MIT)
/*
 * Flattened Image Tree file for SAMA7D65-CURIOSITY Pro board
 *
 * Copyright (C) 2025 Microchip Technology Inc. and its subsidiaries
 *
 * Author: Ryan Wanner <ryan.wanner@microchip.com>
 */
/dts-v1/;

/ {
	description = "Microchip SAMA7D65-CURIOSITY-Pro FIT Image";
	#address-cells = <1>;

	images {
		kernel {
			description = "Linux4SAM Linux kernel";
			data = /incbin/("./zImage");
			type = "kernel";
			arch = "arm";
			os = "linux";
			compression = "none";
			load = <0x62000000>;
			entry = <0x62000000>;
			hash-1 {
				algo = "crc32";
			};
			hash-2 {
				algo = "sha1";
			};
		};

		base_fdt {
			description = "SAMA7D65-CURIOSITY-PRO Flattened Device Tree blob";
			data = /incbin/("./at91-sama7d65_curiosity_pro.dtb");
			type = "flat_dt";
			arch = "arm";
			compression = "none";
			load = <0x61000000>;
			hash-1 {
				algo = "crc32";
			};
			hash-2 {
				algo = "sha1";
			};
		};

		fdt_mipi {
			description = "Device Tree blob mipi display overlay";
			data = /incbin/("./sama7d65_curiosity_pro/sama7d65_curiosity_pro_mipi.dtbo");
			type = "flat_dt";
			arch = "arm";
			compression = "none";
			load = <0x61100000>;
			hash-1 {
				algo = "crc32";
			};
			hash-2 {
				algo = "sha1";
			};
		};

		fdt_lvds {
			description = "Device Tree blob lvds display overlay";
			data = /incbin/("./sama7d65_curiosity_pro/sama7d65_curiosity_pro_lvds.dtbo");
			type = "flat_dt";
			arch = "arm";
			compression = "none";
			load = <0x61100000>;
			hash-1 {
				algo = "crc32";
			};
			hash-2 {
				algo = "sha1";
			};
		};

		fdt_pwm {
			description = "Device Tree blob pwm overlay";
			data = /incbin/("./sama7d65_curiosity_pro/sama7d65_curiosity_pro_pwm.dtbo");
			type = "flat_dt";
			arch = "arm";
			compression = "none";
			load = <0x61200000>;
			hash-1 {
				algo = "crc32";
			};
			hash-2 {
				algo = "sha1";
			};
		};

		fdt_tcb_pwm {
			description = "Device Tree blob tcb pwm overlay";
			data = /incbin/("./sama7d65_curiosity_pro/sama7d65_curiosity_pro_tcb_pwm.dtbo");
			type = "flat_dt";
			arch = "arm";
			compression = "none";
			load = <0x61300000>;
			hash-1 {
				algo = "crc32";
			};
			hash-2 {
				algo = "sha1";
			};
		};
	};

	configurations {
		default = "kernel_dtb";

		kernel_dtb {
			description = "Linux kernel and base FDT blob for SAMA7D65-CURIOSITY-PRO board";
			kernel = "kernel";
			fdt = "base_fdt";
		};

		base_dtb {
			description = "Base FDT blob for SAMA7D65-CURIOSITY-PRO board";
			fdt = "base_fdt";
		};

		mipi {
			description = "FDT overlay blob for mipi display";
			fdt = "fdt_mipi";
		};

		lvds {
			description = "FDT overlay blob for lvds display";
			fdt = "fdt_lvds";
		};

		pwm {
			description = "FDT overlay blob for pwms";
			fdt = "fdt_pwm";
		};

		tcb_pwm {
			description = "FDT overlay blob for tcb pwm";
			fdt = "fdt_tcb_pwm";
		};
	};
};
```

## sama7g54_curiosity.its
```
// SPDX-License-Identifier: (GPL-2.0+ OR MIT)
/*
 * Flattened Image Tree file for SAMA7G54-Curiosity board
 *
 * Copyright (C) 2024 Microchip Technology Inc. and its subsidiaries
 *
 * Author: Charan Pedumuru <charan.pedumuru@microchip.com>
 */
/dts-v1/;

/ {
	description = "Microchip SAMA7G54-Curiosity FIT Image";
	#address-cells = <1>;

	images {
		kernel {
			description = "Linux4SAM Linux kernel";
			data = /incbin/("./zImage");
			type = "kernel";
			arch = "arm";
			os = "linux";
			compression = "none";
			load = <0x62000000>;
			entry = <0x62000000>;
			hash-1 {
				algo = "crc32";
			};
			hash-2 {
				algo = "sha1";
			};
		};

		base_fdt {
			description = "SAMA7G54-Curiosity Flattened Device Tree blob";
			data = /incbin/("./at91-sama7g54_curiosity.dtb");
			type = "flat_dt";
			arch = "arm";
			compression = "none";
			load = <0x61000000>;
			hash-1 {
				algo = "crc32";
			};
			hash-2 {
				algo = "sha1";
			};
		};
	};

	configurations {
		default = "kernel_dtb";

		kernel_dtb {
			description = "Linux kernel and base FDT blob for SAMA7G54-Curiosity board";
			kernel = "kernel";
			fdt = "base_fdt";
		};

		base_dtb {
			description = "Base FDT blob for SAMA7G54-Curiosity board";
			fdt = "base_fdt";
		};
	};
};
```

## sama7g5ek.its
```
// SPDX-License-Identifier: (GPL-2.0+ OR MIT)
/*
 * sama7g5ek.its - Flattened Image Tree file for SAMA7G5-EK board
 *
 * Copyright (C) 2020 Microchip Technology Inc. and its subsidiaries
 *
 * Author: Codrin Ciubotariu <Codrin.Ciubotariu@microchip.com>
 */
/dts-v1/;

/ {
	description = "Microchip SAMA7G5-EK FIT Image";
	#address-cells = <1>;

	images {
		kernel {
			description = "Linux4SAM Linux kernel";
			data = /incbin/("./zImage");
			type = "kernel";
			arch = "arm";
			os = "linux";
			compression = "none";
			load = <0x62000000>;
			entry = <0x62000000>;
			hash@1 {
				algo = "crc32";
			};
			hash@2 {
				algo = "sha1";
			};
		};

		base_fdt {
			description = "SAMA7G5-EK Flattened Device Tree blob";
			data = /incbin/("./at91-sama7g5ek.dtb");
			type = "flat_dt";
			arch = "arm";
			compression = "none";
			load = <0x61000000>;
			hash@1 {
				algo = "crc32";
			};
			hash@2 {
				algo = "sha1";
			};
		};

		fdt_i2s0_proto {
			description = "Device Tree blob PROTO Audio board overlay";
			data = /incbin/("./sama7g5ek/sama7g5ek_i2s0_proto.dtbo");
			type = "flat_dt";
			arch = "arm";
			compression = "none";
			load = <0x61100000>;
			hash@1 {
				algo = "crc32";
			};
			hash@2 {
				algo = "sha1";
			};
		};

		fdt_isc_imx219 {
			description = "Device Tree blob ISC IMX219 overlay";
			data = /incbin/("./sama7g5ek/sama7g5ek_isc_imx219.dtbo");
			type = "flat_dt";
			arch = "arm";
			compression = "none";
			load = <0x61200000>;
			hash@1 {
				algo = "crc32";
			};
			hash@2 {
				algo = "sha1";
			};
		};

		fdt_i2s0_pcm5102a {
			description = "Device Tree blob for PCM5102A overlay";
			data = /incbin/("./sama7g5ek/sama7g5ek_i2s0_pcm5102a.dtbo");
			type = "flat_dt";
			arch = "arm";
			compression = "none";
			load = <0x61300000>;
			hash@1 {
				algo = "crc32";
			};
			hash@2 {
				algo = "sha1";
			};
		};

		fdt_wilc3000 {
			description = "Device Tree blob WILC3000 overlay";
			data = /incbin/("./sama7g5ek/sama7g5ek_wilc3000.dtbo");
			type = "flat_dt";
			arch = "arm";
			compression = "none";
			load = <0x61400000>;
			hash@1 {
				algo = "crc32";
			};
			hash@2 {
				algo = "sha1";
			};
		};
	};

	configurations {
		default = "kernel_dtb";

		kernel_dtb {
			description = "Linux kernel and base FDT blob for SAMA7G5-EK board";
			kernel = "kernel";
			fdt = "base_fdt";
		};

		base_dtb {
			description = "Base FDT blob for SAMA7G5-EK board";
			fdt = "base_fdt";
		};

		i2s0_proto {
			description = "FDT overlay blob for I2S PROTO audio board";
			fdt = "fdt_i2s0_proto";
		};

		imx219 {
			description = "FDT overlay blob for ISC IMX219 sensor";
			fdt = "fdt_isc_imx219";
		};

		i2s0_pcm5102a {
			description = "FDT overlay blob for TI PCM5102a codec";
			fdt = "fdt_i2s0_pcm5102a";
		};

		wilc {
			description = "FDT overlay blob for WILC wireless device";
			fdt = "fdt_wilc3000";
		};
	};
};
```
