## pic64gx_curiosity_kit.its
```
// SPDX-License-Identifier: (GPL-2.0+ OR MIT)
/*
 * Flattened Image Tree file for PIC64GX Curiosity Kit
 *
 * Copyright (C) 2024 Microchip Technology Inc. and its subsidiaries.
 * Author: Conor Dooley <conor.dooley@microchip.com>
 *
 */

/dts-v1/;

/ {
	description = "U-Boot fitImage for the PIC64GX";
	#address-cells = <2>;

		images {
			kernel {
				description = "Linux kernel";
				data = /incbin/("./Image.gz");
				type = "kernel";
				arch = "riscv";
				os = "linux";
				compression = "gzip";
				load = <0x80200000>;
				entry = <0x80200000>;
				hash-1 {
					algo = "sha256";
				};
			};
			base_fdt {
				description = "Flattened Device Tree blob";
				data = /incbin/("./dts/microchip/pic64gx-curiosity-kit.dtb");
				type = "flat_dt";
				arch = "riscv";
				compression = "none";
				load = <0x8a000000>;
				hash-1 {
					algo = "sha256";
				};
			};
			fdt_amp {
				description = "Device Tree blob for AMP";
				data = /incbin/("./pic64gx_curiosity_kit/pic64gx_curiosity_kit_amp.dtbo");
				type = "flat_dt";
				arch = "riscv";
				compression = "none";
				load = <0x8a0b0000>;
				hash-1 {
					algo = "sha256";
				};
			};

			fdt_ov5647 {
				description = "Device Tree blob for ov5647";
				data = /incbin/("./pic64gx_curiosity_kit/pic64gx_curiosity_kit_capture_pipeline_with_ov5647.dtbo");
				type = "flat_dt";
				arch = "riscv";
				compression = "none";
				load = <0x8a0d0000>;
				hash-1 {
					algo = "sha256";
				};
			};
		};

		configurations {
			default = "kernel_dtb";
			kernel_dtb {
				description = "1 Linux kernel, FDT blob";
				kernel = "kernel";
				fdt = "base_fdt";
			};

			base_dtb {
				description = "Base FDT blob for PIC64GX Curiosity Kit";
				fdt = "base_fdt";
			};

			amp {
				description = "FDT overlay blob for AMP";
				fdt = "fdt_amp";
			};

			ov5647 {
				description = "FDT overlay blob for ov5647";
				fdt = "fdt_ov5647";
			};
		};
};
```

## sam9x60_curiosity.its
```
// SPDX-License-Identifier: (GPL-2.0+ OR MIT)
/*
 * sam9x60_curiosity.its - Flattened Image Tree file for SAM9X60 Curiosity board
 *
 * Copyright (C) 2021 Microchip Technology Inc. and its subsidiaries
 *
 * Author: Hari Prasath G.E <Hari.PrasathGE@microchip.com>
 */
/dts-v1/;

/ {
	description = "Microchip SAM9X60-Curiosity FIT Image";
	#address-cells = <1>;

	images {
		kernel {
			description = "Linux4SAM Linux kernel";
			data = /incbin/("./zImage");
			type = "kernel";
			arch = "arm";
			os = "linux";
			compression = "none";
			load = <0x22000000>;
			entry = <0x22000000>;
			hash-1 {
				algo = "crc32";
			};
			hash-2 {
				algo = "sha1";
			};
		};

		base_fdt {
			description = "SAM9X60-Curiosity Flattened Device Tree blob";
			data = /incbin/("./at91-sam9x60_curiosity.dtb");
			type = "flat_dt";
			arch = "arm";
			compression = "none";
			load = <0x23000000>;
			hash-1 {
				algo = "crc32";
			};
			hash-2 {
				algo = "sha1";
			};
		};

		fdt_pda5 {
			description = "Device Tree blob pda5000 overlay";
			data = /incbin/("./sam9x60_curiosity/sam9x60_curiosity_pda5.dtbo");
			type = "flat_dt";
			arch = "arm";
			compression = "none";
			load = <0x23100000>;
			hash-1 {
				algo = "crc32";
			};
			hash-2 {
				algo = "sha1";
			};
		};

		fdt_wilc3000 {
			description = "Device Tree blob WILC3000 overlay";
			data =
			/incbin/("./sam9x60_curiosity/sam9x60_curiosity_wilc3000.dtbo");
			type = "flat_dt";
			arch = "arm";
			compression = "none";
			load = <0x23110000>;
			hash-1 {
				algo = "crc32";
			};
			hash-2 {
				algo = "sha1";
			};
		};

    };

	configurations {
		default = "kernel_dtb";

		kernel_dtb {
			description = "Linux kernel and base FDT blob for SAM9X60-Curiosity board";
			kernel = "kernel";
			fdt = "base_fdt";
		};

		base_dtb {
			description = "Base FDT blob for SAM9X60-Curiosity board";
			fdt = "base_fdt";
		};

		pda5 {
			description = "FDT overlay blob for PDA TM5000 screen";
			fdt = "fdt_pda5";
		};

		wilc {
			description = "FDT overlay blob for WILC3000";
			fdt = "fdt_wilc3000";
		};
	};
};
```

## sam9x60ek.its
```
// SPDX-License-Identifier: (GPL-2.0+ OR MIT)
/*
 * sam9x60ek.its - Flattened Image Tree file for SAM9X60-EK board
 *
 * Copyright (C) 2018 Microchip Technology Inc. and its subsidiaries
 *
 * Author: Nicolas Ferre <nicolas.ferre@microchip.com>
 */
/dts-v1/;

/ {
	description = "Microchip SAM9X60-EK FIT Image";
	#address-cells = <1>;

	images {
		kernel@1 {
			description = "Linux4SAM Linux kernel";
			data = /incbin/("./zImage");
			type = "kernel";
			arch = "arm";
			os = "linux";
			compression = "none";
			load = <0x22000000>;
			entry = <0x22000000>;
			hash@1 {
				algo = "crc32";
			};
			hash@2 {
				algo = "sha1";
			};
		};

		base_fdt {
			description = "SAM9X60-EK Flattened Device Tree blob";
			data = /incbin/("./at91-sam9x60ek.dtb");
			type = "flat_dt";
			arch = "arm";
			compression = "none";
			load = <0x23000000>;
			hash@1 {
				algo = "crc32";
			};
			hash@2 {
				algo = "sha1";
			};
		};

		fdt_isi {
			description = "Device Tree blob ISI overlay";
			data = /incbin/("./sam9x60ek/sam9x60ek_isi.dtbo");
			type = "flat_dt";
			arch = "arm";
			compression = "none";
			load = <0x23100000>;
			hash@1 {
				algo = "crc32";
			};
			hash@2 {
				algo = "sha1";
			};
		};

		fdt_ov2640 {
			description = "Device Tree blob ov2640 overlay";
			data = /incbin/("./sam9x60ek/sam9x60ek_ov2640.dtbo");
			type = "flat_dt";
			arch = "arm";
			compression = "none";
			load = <0x23110000>;
			hash@1 {
				algo = "crc32";
			};
			hash@2 {
				algo = "sha1";
			};
		};

		fdt_pda4 {
			description = "Device Tree blob pda4300 overlay";
			data = /incbin/("./sam9x60ek/sam9x60ek_pda4.dtbo");
			type = "flat_dt";
			arch = "arm";
			compression = "none";
			load = <0x23130000>;
			hash@1 {
				algo = "crc32";
			};
			hash@2 {
				algo = "sha1";
			};
		};

		fdt_pda5 {
			description = "Device Tree blob pda5000 overlay";
			data = /incbin/("./sam9x60ek/sam9x60ek_pda5.dtbo");
			type = "flat_dt";
			arch = "arm";
			compression = "none";
			load = <0x23140000>;
			hash@1 {
				algo = "crc32";
			};
			hash@2 {
				algo = "sha1";
			};
		};

		fdt_pda7 {
			description = "Device Tree blob pda7000 overlay";
			data = /incbin/("./sam9x60ek/sam9x60ek_pda7.dtbo");
			type = "flat_dt";
			arch = "arm";
			compression = "none";
			load = <0x23150000>;
			hash@1 {
				algo = "crc32";
			};
			hash@2 {
				algo = "sha1";
			};
		};

		fdt_pda7b {
			description = "Device Tree blob pda7000b overlay";
			data = /incbin/("./sam9x60ek/sam9x60ek_pda7b.dtbo");
			type = "flat_dt";
			arch = "arm";
			compression = "none";
			load = <0x23160000>;
			hash@1 {
				algo = "crc32";
			};
			hash@2 {
				algo = "sha1";
			};
		};

		fdt_i2s_proto {
			description = "Device Tree blob PROTO Audio board overlay";
			data = /incbin/("./sam9x60ek/sam9x60ek_i2s_proto.dtbo");
			type = "flat_dt";
			arch = "arm";
			compression = "none";
			load = <0x23170000>;
			hash@1 {
				algo = "crc32";
			};
			hash@2 {
				algo = "sha1";
			};
		};

		fdt_wilc {
			description = "Device Tree blob WILC3000 overlay";
			data = /incbin/("./sam9x60ek/sam9x60ek_wilc.dtbo");
			type = "flat_dt";
			arch = "arm";
			compression = "none";
			load = <0x23180000>;
			hash@1 {
				algo = "crc32";
			};
			hash@2 {
				algo = "sha1";
			};
		};

		fdt_mt9v022 {
			description = "Device Tree blob MT9V022 overlay";
			data = /incbin/("./sam9x60ek/sam9x60ek_mt9v022.dtbo");
			type = "flat_dt";
			arch = "arm";
			compression = "none";
			load = <0x23190000>;
			hash@1 {
				algo = "crc32";
			};
			hash@2 {
				algo = "sha1";
			};
		};
	};

	configurations {
		default = "kernel_dtb";

		kernel_dtb {
			description = "Linux kernel and base FDT blob for SAM9X60-EK board";
			kernel = "kernel@1";
			fdt = "base_fdt";
		};

		base_dtb {
			description = "Base FDT blob for SAM9X60-EK board";
			fdt = "base_fdt";
		};

		isi {
			description = "FDT overlay blob for ISI controller";
			fdt = "fdt_isi";
		};

		ov2640 {
			description = "FDT overlay blob for ov2640 sensor";
			fdt = "fdt_ov2640";
		};

		mt9v022 {
			description = "FDT overlay blob for mt9v022 sensor";
			fdt = "fdt_mt9v022";
		};

		pda4 {
			description = "FDT overlay blob for PDA TM4300 screen";
			fdt = "fdt_pda4";
		};

		pda5 {
			description = "FDT overlay blob for PDA TM5000 screen";
			fdt = "fdt_pda5";
		};

		pda7 {
			description = "FDT overlay blob for PDA TM7000 screen";
			fdt = "fdt_pda7";
		};

		pda7b {
			description = "FDT overlay blob for PDA TM7000B screen";
			fdt = "fdt_pda7b";
		};

		i2s_proto {
			description = "FDT overlay blob for I2S PROTO audio board";
			fdt = "fdt_i2s_proto";
		};

		wilc {
			description = "FDT overlay blob for WILC3000";
			fdt = "fdt_wilc";
		};
	};
};
```

## sam9x75_curiosity.its
```
// SPDX-License-Identifier: (GPL-2.0+ OR MIT)
/*
 * Flattened Image Tree file for SAM9X75-Curiosity board
 *
 * Copyright (C) 2023 Microchip Technology Inc. and its subsidiaries
 *
 * Author: Varshini Rajendran <Varshini.Rajendran@microchip.com>
 */
/dts-v1/;

/ {
	description = "Microchip SAM9X75-Curiosity FIT Image";
	#address-cells = <1>;

	images {
		kernel {
			description = "Linux4SAM Linux kernel";
			data = /incbin/("./zImage");
			type = "kernel";
			arch = "arm";
			os = "linux";
			compression = "none";
			load = <0x22000000>;
			entry = <0x22000000>;
			hash-1 {
				algo = "crc32";
			};
			hash-2 {
				algo = "sha1";
			};
		};

		base_fdt {
			description = "SAM9X75-Curiosity Flattened Device Tree blob";
			data = /incbin/("./at91-sam9x75_curiosity.dtb");
			type = "flat_dt";
			arch = "arm";
			compression = "none";
			load = <0x23000000>;
			hash-1 {
				algo = "crc32";
			};
			hash-2 {
				algo = "sha1";
			};
		};

		fdt_isc_imx219 {
			description = "Device Tree blob ISC IMX219 overlay";
			data = /incbin/("./sam9x75_curiosity/sam9x75_curiosity_isc_imx219.dtbo");
			type = "flat_dt";
			arch = "arm";
			compression = "none";
			load = <0x23100000>;
			hash-1 {
				algo = "crc32";
			};
			hash-2 {
				algo = "sha1";
			};
		};

		fdt_lvds_panel {
			description = "Device Tree blob for AC69T88A LVDS Display Panel";
			data = /incbin/("./sam9x75_curiosity/sam9x75_curiosity_lvds_display.dtbo");
			type = "flat_dt";
			arch = "arm";
			compression = "none";
			load = <0x23110000>;
			hash-1 {
				algo = "crc32";
			};
			hash-2 {
				algo = "sha1";
			};
		};

		fdt_gmac_lan8840 {
			description = "Device Tree blob for LAN8840 RGMII PHY overlay";
			data = /incbin/("./sam9x75_curiosity/sam9x75_curiosity_gmac_lan8840.dtbo");
			type = "flat_dt";
			arch = "arm";
			compression = "none";
			load = <0x23120000>;
			hash-1 {
				algo = "crc32";
			};
			hash-2 {
				algo = "sha1";
			};
		};

		fdt_gmac_lan9646 {
			description = "Device Tree blob for LAN9646 RGMII switch overlay";
			data = /incbin/("./sam9x75_curiosity/sam9x75_curiosity_gmac_lan9646.dtbo");
			type = "flat_dt";
			arch = "arm";
			compression = "none";
			load = <0x23120000>;
			hash-1 {
				algo = "crc32";
			};
			hash-2 {
				algo = "sha1";
			};
		};

		fdt_gmac_ksz9477 {
			description = "Device Tree blob for KSZ9477 RGMII switch overlay";
			data = /incbin/("./sam9x75_curiosity/sam9x75_curiosity_gmac_ksz9477.dtbo");
			type = "flat_dt";
			arch = "arm";
			compression = "none";
			load = <0x23120000>;
			hash-1 {
				algo = "crc32";
			};
			hash-2 {
				algo = "sha1";
			};
		};

		fdt_gmac_ksz9563 {
			description = "Device Tree blob for KSZ9563 RGMII switch overlay";
			data = /incbin/("./sam9x75_curiosity/sam9x75_curiosity_gmac_ksz9563.dtbo");
			type = "flat_dt";
			arch = "arm";
			compression = "none";
			load = <0x23120000>;
			hash-1 {
				algo = "crc32";
			};
			hash-2 {
				algo = "sha1";
			};
		};

		fdt_i2s_proto {
			description = "Device Tree blob PROTO Audio board overlay";
			data = /incbin/("./sam9x75_curiosity/sam9x75_curiosity_i2s_proto.dtbo");
			type = "flat_dt";
			arch = "arm";
			compression = "none";
			load = <0x23130000>;
			hash-1 {
				algo = "crc32";
			};
			hash-2 {
				algo = "sha1";
			};
		};

		fdt_mipi_panel {
			description = "Device Tree blob for AC40T08A MPU32 MIPI Display Panel";
			data = /incbin/("./sam9x75_curiosity/sam9x75_curiosity_mipi_display.dtbo");
			type = "flat_dt";
			arch = "arm";
			compression = "none";
			load = <0x23140000>;
			hash-1 {
				algo = "crc32";
			};
			hash-2 {
				algo = "sha1";
			};
		};

		fdt_pwm {
			description = "Device Tree blob for PWM signals";
			data = /incbin/("./sam9x75_curiosity/sam9x75_curiosity_pwm.dtbo");
			type = "flat_dt";
			arch = "arm";
			compression = "none";
			load = <0x23150000>;
			hash-1 {
				algo = "crc32";
			};
			hash-2 {
				algo = "sha1";
			};
		};

		fdt_spi_click {
			description = "Device Tree blob at25ff321a spi flash clickboard overlay";
			data = /incbin/("./sam9x75_curiosity/sam9x75_curiosity_at25ff321a_click.dtbo");
			type = "flat_dt";
			arch = "arm";
			compression = "none";
			load = <0x23160000>;
			hash-1 {
				algo = "crc32";
			};
			hash-2 {
				algo = "sha1";
			};
		};
	};

	configurations {
		default = "kernel_dtb";

		kernel_dtb {
			description = "Linux kernel and base FDT blob for SAM9X75-Curiosity board";
			kernel = "kernel";
			fdt = "base_fdt";
		};

		base_dtb {
			description = "Base FDT blob for SAM9X75-Curiosity board";
			fdt = "base_fdt";
		};

		imx219 {
			description = "FDT overlay blob for ISC IMX219 sensor";
			fdt = "fdt_isc_imx219";
		};

		lvds {
			description = "FDT overlay blob for AC69T88A LVDS Display Panel";
			fdt = "fdt_lvds_panel";
		};

		ksz9131 {
			description = "FDT overlay blob for KSZ9131 RGMII PHY Daughter Card";
			fdt = "fdt_gmac_lan8840";
		};

		lan8840 {
			description = "FDT overlay blob for LAN8840 RGMII PHY Daughter Card";
			fdt = "fdt_gmac_lan8840";
		};

		lan9646 {
			description = "FDT overlay blob for LAN9646 RGMII switch Daughter Card";
			fdt = "fdt_gmac_lan9646";
		};

		ksz9477 {
			description = "FDT overlay blob for KSZ9477 RGMII switch Daughter Card";
			fdt = "fdt_gmac_ksz9477";
		};

		ksz9563 {
			description = "FDT overlay blob for KSZ9563 RGMII switch Daughter Card";
			fdt = "fdt_gmac_ksz9563";
		};

		i2s_proto {
			description = "FDT overlay blob for I2S PROTO audio board";
			fdt = "fdt_i2s_proto";
		};

		mipi {
			description = "FDT overlay blob for AC40T08A MPU32 MIPI Display Panel";
			fdt = "fdt_mipi_panel";
		};

                pwm {
                        description = "FDT overlay blob for PWM";
                        fdt = "fdt_pwm";
                };

		spi_click {
			description = "FDT overlay blob for at25ff321a spi flash clickboard";
			fdt = "fdt_spi_click";
		};
	};
};
```
