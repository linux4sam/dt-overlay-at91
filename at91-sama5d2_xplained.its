## sama5d2_icp.its
```
// SPDX-License-Identifier: (GPL-2.0+ OR MIT)
/*
 * sama5d2_icp.its - Flattened Image Tree file for SAMA5D2-ICP board
 *
 * Copyright (C) 2019 Microchip Technology, Inc.
 * Author: Razvan Stefanescu <razvan.stefanescu@microchip.com>
 *
 */
/dts-v1/;

/ {
	description = "Microchip SAMA5D2-ICP FIT Image";
	#address-cells = <1>;

	images {
		kernel@1 {
			description = "Linux4SAM Linux kernel";
			data = /incbin/("./zImage");
			type = "kernel";
			arch = "arm";
			os = "linux";
			compression = "none";
			load = <0x22000000>;
			entry = <0x22000000>;
			hash@1 {
				algo = "crc32";
			};
			hash@2 {
				algo = "sha1";
			};
		};

		base_fdt {
			description = "Flattened Device Tree blob";
			data = /incbin/("./at91-sama5d2_icp.dtb");
			type = "flat_dt";
			arch = "arm";
			compression = "none";
			load = <0x23000000>;
			hash@1 {
				algo = "crc32";
			};
			hash@2 {
				algo = "sha1";
			};
		};

		fdt_wilc {
			description = "Device Tree blob WILC3000 overlay";
			data = /incbin/("./sama5d2_icp/sama5d2_icp_wilc.dtbo");
			type = "flat_dt";
			arch = "arm";
			compression = "none";
			load = <0x23100000>;
			hash@1 {
				algo = "crc32";
			};
			hash@2 {
				algo = "sha1";
			};
		};
	};

	configurations {
		default = "kernel_dtb";

		kernel_dtb {
			description = "Linux kernel and base FDT blob for SAMA5D2-ICP board";
			kernel = "kernel@1";
			fdt = "base_fdt";
		};

		base_dtb {
			description = "Base FDT blob for SAMA5D2-ICP board";
			fdt = "base_fdt";
		};

		wilc {
			description = "FDT overlay blob for WILC3000";
			fdt = "fdt_wilc";
		};
	};
};
```

## sama5d2_ptc_ek.its
```
// SPDX-License-Identifier: (GPL-2.0+ OR MIT)
/*
 * sama5d2_ptc_ek.its - Flattened Image Tree file for SAMA5D2-PTC-EK board
 *
 * Copyright (C) 2018 Microchip Technology, Inc.
 * Author: Cristian Birsan <cristian.birsan@microchip.com>
 *
 */
/dts-v1/;

/ {
	description = "Microchip SAMA5D2 PTC EK FIT Image";
	#address-cells = <1>;

	images {
		kernel@1 {
			description = "Linux4SAM Linux kernel";
			data = /incbin/("./zImage");
			type = "kernel";
			arch = "arm";
			os = "linux";
			compression = "none";
			load = <0x22000000>;
			entry = <0x22000000>;
			hash@1 {
				algo = "crc32";
			};
			hash@2 {
				algo = "sha1";
			};
		};

		base_fdt {
			description = "Flattened Device Tree blob";
			data = /incbin/("./at91-sama5d2_ptc_ek.dtb");
			type = "flat_dt";
			arch = "arm";
			compression = "none";
			load = <0x23000000>;
			hash@1 {
				algo = "crc32";
			};
			hash@2 {
				algo = "sha1";
			};
		};

		fdt_pda4 {
			description = "Device Tree blob pda4300 overlay";
			data = /incbin/("./sama5d2_ptc_ek/sama5d2_ptc_ek_pda4.dtbo");
			type = "flat_dt";
			arch = "arm";
			compression = "none";
			load = <0x23130000>;
			hash@1 {
				algo = "crc32";
			};
			hash@2 {
				algo = "sha1";
			};
		};

		fdt_pda5 {
			description = "Device Tree blob pda5000 overlay";
			data = /incbin/("./sama5d2_ptc_ek/sama5d2_ptc_ek_pda5.dtbo");
			type = "flat_dt";
			arch = "arm";
			compression = "none";
			load = <0x23140000>;
			hash@1 {
				algo = "crc32";
			};
			hash@2 {
				algo = "sha1";
			};
		};

		fdt_ptc {
			description = "Device Tree blob PTC overlay";
			data = /incbin/("./sama5d2_ptc_ek/sama5d2_ptc_ek_ptc.dtbo");
			type = "flat_dt";
			arch = "arm";
			compression = "none";
			load = <0x23150000>;
			hash@1 {
				algo = "crc32";
			};
			hash@2 {
				algo = "sha1";
			};
		};
	};

	configurations {
		default = "kernel_dtb";

		kernel_dtb {
			description = "Linux kernel and base FDT blob for SAMA5D2_PTC_EK board";
			kernel = "kernel@1";
			fdt = "base_fdt";
		};

		base_dtb {
			description = "Base FDT blob for SAMA5D2_PTC_EK board";
			fdt = "base_fdt";
		};

		pda4 {
			description = "FDT overlay blob for PDA TM4300 screen";
			fdt = "fdt_pda4";
		};

		pda5 {
			description = "FDT overlay blob for PDA TM5000 screen";
			fdt = "fdt_pda5";
		};

		ptc {
			description = "FDT overlay blob for PTC";
			fdt = "fdt_ptc";
		};
	};
};
```

## sama5d2_xplained.its
```
// SPDX-License-Identifier: (GPL-2.0+ OR MIT)
/*
 * Flattened Image Tree file for SAMA5D2 Xplained board
 *
 * Copyright (C) 2018 Microchip Technology, Inc.
 * Author: Cristian Birsan <cristian.birsan@microchip.com>
 *
 */
/dts-v1/;

/ {
	description = "Microchip SAMA5D2 Xplained FIT Image";
	#address-cells = <1>;

	images {
		kernel {
			description = "Linux4SAM Linux kernel";
			data = /incbin/("./zImage");
			type = "kernel";
			arch = "arm";
			os = "linux";
			compression = "none";
			load = <0x22000000>;
			entry = <0x22000000>;
			hash-1 {
				algo = "crc32";
			};
			hash-2 {
				algo = "sha1";
			};
		};

		base_fdt {
			description = "Flattened Device Tree blob";
			data = /incbin/("./at91-sama5d2_xplained.dtb");
			type = "flat_dt";
			arch = "arm";
			compression = "none";
			load = <0x23000000>;
			hash-1 {
				algo = "crc32";
			};
			hash-2 {
				algo = "sha1";
			};
		};

		fdt_isc {
			description = "Device Tree blob ISC overlay";
			data = /incbin/("./sama5d2_xplained/sama5d2_xplained_isc.dtbo");
			type = "flat_dt";
			arch = "arm";
			compression = "none";
			load = <0x23100000>;
			hash-1 {
				algo = "crc32";
			};
			hash-2 {
				algo = "sha1";
			};
		};

		fdt_ov7670 {
			description = "Device Tree blob Ov7670 overlay";
			data = /incbin/("./sama5d2_xplained/sama5d2_xplained_ov7670.dtbo");
			type = "flat_dt";
			arch = "arm";
			compression = "none";
			load = <0x23110000>;
			hash-1 {
				algo = "crc32";
			};
			hash-2 {
				algo = "sha1";
			};
		};

		fdt_ov7740 {
			description = "Device Tree blob OV7740 overlay";
			data = /incbin/("./sama5d2_xplained/sama5d2_xplained_ov7740.dtbo");
			type = "flat_dt";
			arch = "arm";
			compression = "none";
			load = <0x23120000>;
			hash-1 {
				algo = "crc32";
			};
			hash-2 {
				algo = "sha1";
			};
		};

		fdt_pda4 {
			description = "Device Tree blob pda4300 overlay";
			data = /incbin/("./sama5d2_xplained/sama5d2_xplained_pda4.dtbo");
			type = "flat_dt";
			arch = "arm";
			compression = "none";
			load = <0x23130000>;
			hash-1 {
				algo = "crc32";
			};
			hash-2 {
				algo = "sha1";
			};
		};

		fdt_pda5 {
			description = "Device Tree blob pda5000 overlay";
			data = /incbin/("./sama5d2_xplained/sama5d2_xplained_pda5.dtbo");
			type = "flat_dt";
			arch = "arm";
			compression = "none";
			load = <0x23140000>;
			hash-1 {
				algo = "crc32";
			};
			hash-2 {
				algo = "sha1";
			};
		};

		fdt_pda7 {
			description = "Device Tree blob pda7000 overlay";
			data = /incbin/("./sama5d2_xplained/sama5d2_xplained_pda7.dtbo");
			type = "flat_dt";
			arch = "arm";
			compression = "none";
			load = <0x23150000>;
			hash-1 {
				algo = "crc32";
			};
			hash-2 {
				algo = "sha1";
			};
		};

		fdt_pda7b {
			description = "Device Tree blob pda7000b overlay";
			data = /incbin/("./sama5d2_xplained/sama5d2_xplained_pda7b.dtbo");
			type = "flat_dt";
			arch = "arm";
			compression = "none";
			load = <0x23160000>;
			hash-1 {
				algo = "crc32";
			};
			hash-2 {
				algo = "sha1";
			};
		};

		fdt_i2s0_proto {
			description = "Device Tree blob PROTO Audio board overlay";
			data = /incbin/("./sama5d2_xplained/sama5d2_xplained_i2s0_proto.dtbo");
			type = "flat_dt";
			arch = "arm";
			compression = "none";
			load = <0x23170000>;
			hash-1 {
				algo = "crc32";
			};
			hash-2 {
				algo = "sha1";
			};
		};

		fdt_qspi {
			description = "Device Tree blob QSPI overlay";
			data = /incbin/("./sama5d2_xplained/sama5d2_xplained_qspi.dtbo");
			type = "flat_dt";
			arch = "arm";
			compression = "none";
			load = <0x23180000>;
			hash-1 {
				algo = "crc32";
			};
			hash-2 {
				algo = "sha1";
			};
		};

		fdt_ov5640 {
			description = "Device Tree blob OV5640 overlay";
			data = /incbin/("./sama5d2_xplained/sama5d2_xplained_ov5640.dtbo");
			type = "flat_dt";
			arch = "arm";
			compression = "none";
			load = <0x23190000>;
			hash-1 {
				algo = "crc32";
			};
			hash-2 {
				algo = "sha1";
			};
		};

		fdt_flx0_i2c {
			description = "Device Tree blob flx0 as I2C overlay";
			data = /incbin/("./sama5d2_xplained/sama5d2_xplained_flx0_i2c.dtbo");
			type = "flat_dt";
			arch = "arm";
			compression = "none";
			load = <0x231a0000>;
			hash-1 {
				algo = "crc32";
			};
			hash-2 {
				algo = "sha1";
			};
		};

		fdt_mt9v022 {
			description = "Device Tree blob MT9V022 overlay";
			data = /incbin/("./sama5d2_xplained/sama5d2_xplained_mt9v022.dtbo");
			type = "flat_dt";
			arch = "arm";
			compression = "none";
			load = <0x23200000>;
			hash-1 {
				algo = "crc32";
			};
			hash-2 {
				algo = "sha1";
			};
		};
	};

	configurations {
		default = "kernel_dtb";

		kernel_dtb {
			description = "Linux kernel and base FDT blob for SAMA5D2_XPLAINED board";
			kernel = "kernel";
			fdt = "base_fdt";
		};

		base_dtb {
			description = "Base FDT blob for SAMA5D2_XPLAINED board";
			fdt = "base_fdt";
		};

		isc {
			description = "FDT overlay blob for isc";
			fdt = "fdt_isc";
		};

		ov7670 {
			description = "FDT overlay blob for ov7670 sensor";
			fdt = "fdt_ov7670";
		};

		ov7740 {
			description = "FDT overlay blob for ov7740 sensor";
			fdt = "fdt_ov7740";
		};

		ov5640 {
			description = "FDT overlay blob for ov5640 sensor";
			fdt = "fdt_ov5640";
		};

		mt9v022 {
			description = "FDT overlay blob for mt9v022 sensor";
			fdt = "fdt_mt9v022";
		};

		pda4 {
			description = "FDT overlay blob for PDA TM4300 screen";
			fdt = "fdt_pda4";
		};

		pda5 {
			description = "FDT overlay blob for PDA TM5000 screen";
			fdt = "fdt_pda5";
		};

		pda7 {
			description = "FDT overlay blob for PDA TM7000 screen";
			fdt = "fdt_pda7";
		};

		pda7b {
			description = "FDT overlay blob for PDA TM7000B screen";
			fdt = "fdt_pda7b";
		};

		i2s0_proto {
			description = "FDT overlay blob for I2S0 PROTO audio board";
			fdt = "fdt_i2s0_proto";
		};

		qspi {
			description = "FDT overlay blob for QSPI memory";
			fdt = "fdt_qspi";
		};

		flx0_i2c {
			description = "FDT overlay blob to configure flx0 as I2C";
			fdt = "fdt_flx0_i2c";
		};

	};
};
```

## sama5d2_xplained_grts.its
```
// SPDX-License-Identifier: (GPL-2.0+ OR MIT)
/*
 * Flattened Image Tree file for SAMA5D2 Xplained
 * adapted board for Resistive touchscreen
 *
 * Copyright (C) 2018 Microchip Technology, Inc.
 * Author: Eugen Hristev <eugen.hristev@microchip.com>
 *
 */
/dts-v1/;

/ {
	description = "Microchip SAMA5D2 Xplained FIT Image";
	#address-cells = <1>;

	images {
		kernel {
			description = "Linux4SAM Linux kernel";
			data = /incbin/("./zImage");
			type = "kernel";
			arch = "arm";
			os = "linux";
			compression = "none";
			load = <0x22000000>;
			entry = <0x22000000>;
			hash-1 {
				algo = "crc32";
			};
			hash-2 {
				algo = "sha1";
			};
		};

		base_fdt {
			description = "Flattened Device Tree blob";
			data = /incbin/("./at91-sama5d2_xplained.dtb");
			type = "flat_dt";
			arch = "arm";
			compression = "none";
			load = <0x23000000>;
			hash-1 {
				algo = "crc32";
			};
			hash-2 {
				algo = "sha1";
			};
		};

		fdt_grts {
			description = "Device Tree blob Resistive touch Adapted board";
			data = /incbin/("./sama5d2_xplained_grts/sama5d2_xplained_grts.dtbo");
			type = "flat_dt";
			arch = "arm";
			compression = "none";
			load = <0x23190000>;
			hash-1 {
				algo = "crc32";
			};
			hash-2 {
				algo = "sha1";
			};
		};
	};

	configurations {
		default = "kernel_dtb";

		kernel_dtb {
			description = "Linux kernel and base FDT blob for SAMA5D2_XPLAINED board";
			kernel = "kernel";
			fdt = "base_fdt";
		};

		base_dtb {
			description = "Base FDT blob for SAMA5D2_XPLAINED board";
			fdt = "base_fdt";
		};

		grts {
			description = "FDT overlay blob for Resistive touch Adapted board";
			fdt = "fdt_grts";
		};
	};
};
```
