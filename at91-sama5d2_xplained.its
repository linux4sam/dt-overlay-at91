## sama5d3_eds.its
```
// SPDX-License-Identifier: (GPL-2.0+ OR MIT)
/*
 * Flattened Image Tree file for SAMA5D3 Ethernet
 * Development System board
 *
 * Copyright (C) 2022 Microchip Technology, Inc. and its subsidiaries
 * Author: Jerry Ray <jerry.ray@microchip.com>
 *
 * The following convention is used on this board.
 * Overlays for RMII connector add-on boards are loaded at 0x23120000.
 * Overlays for RGMII connector add-on boards are loaded at 0x23130000.
 *
 */
/dts-v1/;

/ {
	description = "Microchip SAMA5D3-EDS FIT Image";
	#address-cells = <1>;

	images {
		kernel {
			description = "Linux kernel";
			data = /incbin/("./zImage");
			type = "kernel";
			arch = "arm";
			os = "linux";
			compression = "none";
			load = <0x22000000>;
			entry = <0x22000000>;
			hash-1 {
				algo = "crc32";
			};
			hash-2 {
				algo = "sha1";
			};
		};

		/* Base Device Tree */
		base_fdt {
			description = "Flattened Device Tree blob";
			data = /incbin/("./at91-sama5d3_eds.dtb");
			type = "flat_dt";
			arch = "arm";
			compression = "none";
			load = <0x23000000>;
			hash-1 {
				algo = "crc32";
			};
			hash-2 {
				algo = "sha1";
			};
		};

		fdt_lan9303 {
			description = "Device Tree blob lan9303 overlay";
			data = /incbin/("./sama5d3_eds/sama5d3_eds_lan9303.dtbo");
			type = "flat_dt";
			arch = "arm";
			compression = "none";
			load = <0x23120000>;
			hash-1 {
				algo = "crc32";
			};
			hash-2 {
				algo = "sha1";
			};
		};

		fdt_lan9354 {
			description = "Device Tree blob lan9354 overlay";
			data = /incbin/("./sama5d3_eds/sama5d3_eds_lan9354.dtbo");
			type = "flat_dt";
			arch = "arm";
			compression = "none";
			load = <0x23120000>;
			hash-1 {
				algo = "crc32";
			};
			hash-2 {
				algo = "sha1";
			};
		};

		fdt_lan9370 {
			description = "Device Tree blob lan9370 overlay";
			data = /incbin/("./sama5d3_eds/sama5d3_eds_lan9370.dtbo");
			type = "flat_dt";
			arch = "arm";
			compression = "none";
			load = <0x23120000>;
			hash-1 {
				algo = "crc32";
			};
			hash-2 {
				algo = "sha1";
			};
		};

		fdt_lan9374 {
			description = "Device Tree blob lan9374 overlay";
			data = /incbin/("./sama5d3_eds/sama5d3_eds_lan9374.dtbo");
			type = "flat_dt";
			arch = "arm";
			compression = "none";
			load = <0x23130000>;
			hash-1 {
				algo = "crc32";
			};
			hash-2 {
				algo = "sha1";
			};
		};

		fdt_ksz9893 {
			description = "Device Tree blob ksz9893 overlay";
			data = /incbin/("./sama5d3_eds/sama5d3_eds_ksz9893.dtbo");
			type = "flat_dt";
			arch = "arm";
			compression = "none";
			load = <0x23130000>;
			hash-1 {
				algo = "crc32";
			};
			hash-2 {
				algo = "sha1";
			};
		};

		fdt_ksz9477 {
			description = "Device Tree blob ksz9477 overlay";
			data = /incbin/("./sama5d3_eds/sama5d3_eds_ksz9477.dtbo");
			type = "flat_dt";
			arch = "arm";
			compression = "none";
			load = <0x23130000>;
			hash-1 {
				algo = "crc32";
			};
			hash-2 {
				algo = "sha1";
			};
		};

		fdt_ksz9563 {
			description = "Device Tree blob ksz9563 overlay";
			data = /incbin/("./sama5d3_eds/sama5d3_eds_ksz9563.dtbo");
			type = "flat_dt";
			arch = "arm";
			compression = "none";
			load = <0x23130000>;
			hash-1 {
				algo = "crc32";
			};
			hash-2 {
				algo = "sha1";
			};
		};

		fdt_ksz8563 {
			description = "Device Tree blob ksz8563 overlay";
			data = /incbin/("./sama5d3_eds/sama5d3_eds_ksz8563.dtbo");
			type = "flat_dt";
			arch = "arm";
			compression = "none";
			load = <0x23130000>;
			hash-1 {
				algo = "crc32";
			};
			hash-2 {
				algo = "sha1";
			};
		};

		fdt_vsc8541 {
			description = "Device Tree blob vsc8541 PHY overlay";
			data = /incbin/("./sama5d3_eds/sama5d3_eds_vsc8541.dtbo");
			type = "flat_dt";
			arch = "arm";
			compression = "none";
			load = <0x23130000>;
			hash-1 {
				algo = "crc32";
			};
			hash-2 {
				algo = "sha1";
			};
		};

		fdt_lan8830 {
			description = "Device Tree blob lan8830 PHY overlay";
			data = /incbin/("./sama5d3_eds/sama5d3_eds_lan8830.dtbo");
			type = "flat_dt";
			arch = "arm";
			compression = "none";
			load = <0x23130000>;
			hash-1 {
				algo = "crc32";
			};
			hash-2 {
				algo = "sha1";
			};
		};

		fdt_lan8841 {
			description = "Device Tree blob lan8841 PHY overlay";
			data = /incbin/("./sama5d3_eds/sama5d3_eds_lan8841.dtbo");
			type = "flat_dt";
			arch = "arm";
			compression = "none";
			load = <0x23130000>;
			hash-1 {
				algo = "crc32";
			};
			hash-2 {
				algo = "sha1";
			};
		};

		fdt_rgmii {
			description = "Device Tree blob generic RGMII PHY overlay";
			data = /incbin/("./sama5d3_eds/sama5d3_eds_rgmii.dtbo");
			type = "flat_dt";
			arch = "arm";
			compression = "none";
			load = <0x23130000>;
			hash-1 {
				algo = "crc32";
			};
			hash-2 {
				algo = "sha1";
			};
		};

		fdt_rmii {
			description = "Device Tree blob generic rmii PHY overlay";
			data = /incbin/("./sama5d3_eds/sama5d3_eds_rmii.dtbo");
			type = "flat_dt";
			arch = "arm";
			compression = "none";
			load = <0x23120000>;
			hash-1 {
				algo = "crc32";
			};
			hash-2 {
				algo = "sha1";
			};
		};

		fdt_rgmii_irq {
			description = "Device Tree blob generic RGMII PHY overlay w/ IRQ";
			data = /incbin/("./sama5d3_eds/sama5d3_eds_rgmii_irq.dtbo");
			type = "flat_dt";
			arch = "arm";
			compression = "none";
			load = <0x23130000>;
			hash-1 {
				algo = "crc32";
			};
			hash-2 {
				algo = "sha1";
			};
		};

		fdt_rmii_irq {
			description = "Device Tree blob generic rmii PHY overlay w/ IRQ";
			data = /incbin/("./sama5d3_eds/sama5d3_eds_rmii_irq.dtbo");
			type = "flat_dt";
			arch = "arm";
			compression = "none";
			load = <0x23120000>;
			hash-1 {
				algo = "crc32";
			};
			hash-2 {
				algo = "sha1";
			};
		};
	};

	configurations {
		default = "kernel_dtb";

		kernel_dtb {
			description = "Linux kernel and base FDT blob for SAMA5D3_EDS board";
			kernel = "kernel";
			fdt = "base_fdt";
		};

		base_dtb {
			description = "FDT blob for the SAMA5D3_EDS base board";
			fdt = "base_fdt";
		};

		lan9303 {
			description = "FDT overlay blob for LAN9303 RMII add-on board";
			fdt = "fdt_lan9303";
		};

		lan9354 {
			description = "FDT overlay blob for LAN9354 RMII add-on board";
			fdt = "fdt_lan9354";
		};

		lan9370 {
			description = "FDT overlay blob for lan9370 RMII add-on board";
			fdt = "fdt_lan9370";
		};

		lan9374 {
			description = "FDT overlay blob for lan9374 RGMII add-on board";
			fdt = "fdt_lan9374";
		};

		ksz9893 {
			description = "FDT overlay blob for ksz9893 RGMII add-on board";
			fdt = "fdt_ksz9893";
		};

		ksz9477 {
			description = "FDT overlay blob for ksz9477 RGMII add-on board";
			fdt = "fdt_ksz9477";
		};

		ksz9563 {
			description = "FDT overlay blob for ksz9563 RGMII add-on board";
			fdt = "fdt_ksz9563";
		};

		ksz8563 {
			description = "FDT overlay blob for ksz8563 RGMII add-on board";
			fdt = "fdt_ksz8563";
		};

		vsc8541 {
			description = "FDT overlay blob for vsc8541 PHY RGMII add-on board";
			fdt = "fdt_vsc8541";
		};

		lan8830 {
			description = "FDT overlay blob for lan8830 PHY RGMII add-on board";
			fdt = "fdt_lan8830";
		};

		lan8841 {
			description = "FDT overlay blob for lan8841 PHY RGMII add-on board";
			fdt = "fdt_lan8841";
		};

		rgmii {
			description = "FDT overlay blob for generic RGMII PHY add-on board";
			fdt = "fdt_rgmii";
		};

		rmii {
			description = "FDT overlay blob for generic RMII PHY add-on board";
			fdt = "fdt_rmii";
		};

		rgmii_irq {
			description = "FDT overlay blob for generic RGMII PHY add-on board";
			fdt = "fdt_rgmii_irq";
		};

		rmii_irq {
			description = "FDT overlay blob for generic RMII PHY add-on board";
			fdt = "fdt_rmii_irq";
		};
	};
};
```

## sama5d3_xplained.its
```
// SPDX-License-Identifier: (GPL-2.0+ OR MIT)
/*
 * sama5d3_xplained.its - Flattened Image Tree file for SAMA5D3 Xplained board
 *
 * Copyright (C) 2018 Microchip Technology, Inc.
 * Author: Cristian Birsan <cristian.birsan@microchip.com>
 *
 */
/dts-v1/;

/ {
	description = "Microchip SAMA5D3 Xplained FIT Image";
	#address-cells = <1>;

	images {
		kernel@1 {
			description = "Linux4SAM Linux kernel";
			data = /incbin/("./zImage");
			type = "kernel";
			arch = "arm";
			os = "linux";
			compression = "none";
			load = <0x22000000>;
			entry = <0x22000000>;
			hash@1 {
				algo = "crc32";
			};
			hash@2 {
				algo = "sha1";
			};
		};

		base_fdt {
			description = "Flattened Device Tree blob";
			data = /incbin/("./at91-sama5d3_xplained.dtb");
			type = "flat_dt";
			arch = "arm";
			compression = "none";
			load = <0x23000000>;
			hash@1 {
				algo = "crc32";
			};
			hash@2 {
				algo = "sha1";
			};
		};

		fdt_pda4 {
			description = "Device Tree blob pda4300 overlay";
			data = /incbin/("./sama5d3_xplained/sama5d3_xplained_pda4.dtbo");
			type = "flat_dt";
			arch = "arm";
			compression = "none";
			load = <0x23120000>;
			hash@1 {
				algo = "crc32";
			};
			hash@2 {
				algo = "sha1";
			};
		};

		fdt_pda5 {
			description = "Device Tree blob pda5000 overlay";
			data = /incbin/("./sama5d3_xplained/sama5d3_xplained_pda5.dtbo");
			type = "flat_dt";
			arch = "arm";
			compression = "none";
			load = <0x23130000>;
			hash@1 {
				algo = "crc32";
			};
			hash@2 {
				algo = "sha1";
			};
		};

		fdt_pda7 {
			description = "Device Tree blob pda7000 overlay";
			data = /incbin/("./sama5d3_xplained/sama5d3_xplained_pda7.dtbo");
			type = "flat_dt";
			arch = "arm";
			compression = "none";
			load = <0x23140000>;
			hash@1 {
				algo = "crc32";
			};
			hash@2 {
				algo = "sha1";
			};
		};

		fdt_pda7b {
			description = "Device Tree blob pda7000b overlay";
			data = /incbin/("./sama5d3_xplained/sama5d3_xplained_pda7b.dtbo");
			type = "flat_dt";
			arch = "arm";
			compression = "none";
			load = <0x23150000>;
			hash@1 {
				algo = "crc32";
			};
			hash@2 {
				algo = "sha1";
			};
		};
	};

	configurations {
		default = "kernel_dtb";

		kernel_dtb {
			description = "Linux kernel and base FDT blob for SAMA5D3_XPLAINED board";
			kernel = "kernel@1";
			fdt = "base_fdt";
		};

		base_dtb {
			description = "FDT blob for base SAMA5D3_XPLAINED board";
			fdt = "base_fdt";
		};

		pda4 {
			description = "FDT overlay blob for PDA TM4300 screen";
			fdt = "fdt_pda4";
		};

		pda5 {
			description = "FDT overlay blob for PDA TM5000 screen";
			fdt = "fdt_pda5";
		};

		pda7 {
			description = "FDT overlay blob for PDA TM7000 screen";
			fdt = "fdt_pda7";
		};

		pda7b {
			description = "FDT overlay blob for PDA TM7000B screen";
			fdt = "fdt_pda7b";
		};
	};
};
```
