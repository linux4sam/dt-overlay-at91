// SPDX-License-Identifier: (GPL-2.0+ OR MIT)
/*
 * Device Tree file for SAMA5D2 PTC EK board
 * overlay blob for PTC.
 *
 * Copyright (C) 2018 Microchip Technology, Inc.
 * Author: Codrin Ciubotariu <codrin.ciubotariu@microchip.com>
 *
 */
/dts-v1/;
/plugin/;

&{/ahb/apb/ptc@fc060000} {
	status = "okay";
};
