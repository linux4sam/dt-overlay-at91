// SPDX-License-Identifier: (GPL-2.0+ OR MIT)
/*
 * Device Tree file for SAMA5D2 Xplained board
 * overlay blob to configure Flexcom0 as I2C.
 *
 * Copyright (C) 2020 Microchip Technology Inc. and its subsidiaries
 * Author: Codrin Ciubotariu <codrin.ciubotariu@microchip.com>
 *
 */
/dts-v1/;
/plugin/;

#include <dt-bindings/mfd/atmel-flexcom.h>

&isc {
	status = "disabled";
};

&uart5 {
	status = "disabled";
};

&flx0 {
	atmel,flexcom-mode = <ATMEL_FLEXCOM_MODE_TWI>;
	status = "okay"; /* conflict with ISC_D2 & ISC_D3 data pins */
	i2c2: i2c@600 {
		status = "okay";
	};
};
